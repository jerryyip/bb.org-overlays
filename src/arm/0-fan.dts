/dts-v1/;

/ {
	compatible = "ti,beaglebone", "ti,beaglebone-black", "ti,beaglebone-green";
	part-number = "univ-bbgw-EW";
	version = "00A0";
	exclusive-use = "P8.7", "P8.8", "P8.9", "P8.10", "P8.13", "P8.19", "P8.27", "P8.28", "P8.29", "P8.30", "P8.31", "P8.32", "P8.33", "P8.34", "P8.35", "P8.36", "P8.39", "P8.40", "P8.41", "P8.42", "P8.43", "P8.44", "P8.45", "P8.46", "P9.11", "P9.13", "P9.14", "P9.15", "P9.16", "P9.17", "P9.18", "P9.19", "P9.20", "P9.21", "P9.22", "P9.23", "P9.24", "P9.25", "P9.26", "P9.27", "P9.41", "P9.41.1", "P9.42", "P9.93", "P9.95", "P9.96", "P9.97", "uart1", "uart2", "uart4", "uart5", "ehrpwm0A", "ehrpwm0B", "ehrpwm1A", "ehrpwm1B", "ehrpwm2A", "ehrpwm2B", "epwmss0", "ehrpwm0", "ecap0", "epwmss1", "ehrpwm1", "epwmss2", "ehrpwm2", "ecap2", "i2c1", "spi1", "spi0", "dcan0", "dcan1", "pru0", "pru1", "pruss";

	fragment@0 {
		target = <0xffffffff>;

		__overlay__ {

			P9_19_pinmux {
				status = "disabled";
			};

			P9_20_pinmux {
				status = "disabled";
			};

			pinmux_P8_07_default_pin {
				pinctrl-single,pins = <0x90 0x27>;
				linux,phandle = <0x1>;
				phandle = <0x1>;
			};

			pinmux_P8_07_gpio_pin {
				pinctrl-single,pins = <0x90 0x2f>;
				linux,phandle = <0x2>;
				phandle = <0x2>;
			};

			pinmux_P8_07_gpio_pu_pin {
				pinctrl-single,pins = <0x90 0x37>;
				linux,phandle = <0x3>;
				phandle = <0x3>;
			};

			pinmux_P8_07_gpio_pd_pin {
				pinctrl-single,pins = <0x90 0x27>;
				linux,phandle = <0x4>;
				phandle = <0x4>;
			};

			pinmux_P8_07_gpio_input_pin {
				pinctrl-single,pins = <0x90 0x2f>;
				linux,phandle = <0x5>;
				phandle = <0x5>;
			};

			pinmux_P8_07_timer_pin {
				pinctrl-single,pins = <0x90 0x32>;
				linux,phandle = <0x6>;
				phandle = <0x6>;
			};

			pinmux_P8_08_default_pin {
				pinctrl-single,pins = <0x94 0x27>;
				linux,phandle = <0x7>;
				phandle = <0x7>;
			};

			pinmux_P8_08_gpio_pin {
				pinctrl-single,pins = <0x94 0x2f>;
				linux,phandle = <0x8>;
				phandle = <0x8>;
			};

			pinmux_P8_08_gpio_pu_pin {
				pinctrl-single,pins = <0x94 0x37>;
				linux,phandle = <0x9>;
				phandle = <0x9>;
			};

			pinmux_P8_08_gpio_pd_pin {
				pinctrl-single,pins = <0x94 0x27>;
				linux,phandle = <0xa>;
				phandle = <0xa>;
			};

			pinmux_P8_08_gpio_input_pin {
				pinctrl-single,pins = <0x94 0x2f>;
				linux,phandle = <0xb>;
				phandle = <0xb>;
			};

			pinmux_P8_08_timer_pin {
				pinctrl-single,pins = <0x94 0x32>;
				linux,phandle = <0xc>;
				phandle = <0xc>;
			};

			pinmux_P8_09_default_pin {
				pinctrl-single,pins = <0x9c 0x27>;
				linux,phandle = <0xd>;
				phandle = <0xd>;
			};

			pinmux_P8_09_gpio_pin {
				pinctrl-single,pins = <0x9c 0x2f>;
				linux,phandle = <0xe>;
				phandle = <0xe>;
			};

			pinmux_P8_09_gpio_pu_pin {
				pinctrl-single,pins = <0x9c 0x37>;
				linux,phandle = <0xf>;
				phandle = <0xf>;
			};

			pinmux_P8_09_gpio_pd_pin {
				pinctrl-single,pins = <0x9c 0x27>;
				linux,phandle = <0x10>;
				phandle = <0x10>;
			};

			pinmux_P8_09_gpio_input_pin {
				pinctrl-single,pins = <0x9c 0x2f>;
				linux,phandle = <0x11>;
				phandle = <0x11>;
			};

			pinmux_P8_09_timer_pin {
				pinctrl-single,pins = <0x9c 0x32>;
				linux,phandle = <0x12>;
				phandle = <0x12>;
			};

			pinmux_P8_10_default_pin {
				pinctrl-single,pins = <0x98 0x27>;
				linux,phandle = <0x13>;
				phandle = <0x13>;
			};

			pinmux_P8_10_gpio_pin {
				pinctrl-single,pins = <0x98 0x2f>;
				linux,phandle = <0x14>;
				phandle = <0x14>;
			};

			pinmux_P8_10_gpio_pu_pin {
				pinctrl-single,pins = <0x98 0x37>;
				linux,phandle = <0x15>;
				phandle = <0x15>;
			};

			pinmux_P8_10_gpio_pd_pin {
				pinctrl-single,pins = <0x98 0x27>;
				linux,phandle = <0x16>;
				phandle = <0x16>;
			};

			pinmux_P8_10_gpio_input_pin {
				pinctrl-single,pins = <0x98 0x2f>;
				linux,phandle = <0x17>;
				phandle = <0x17>;
			};

			pinmux_P8_10_timer_pin {
				pinctrl-single,pins = <0x98 0x32>;
				linux,phandle = <0x18>;
				phandle = <0x18>;
			};

			pinmux_P8_13_default_pin {
				pinctrl-single,pins = <0x24 0x27>;
				linux,phandle = <0x19>;
				phandle = <0x19>;
			};

			pinmux_P8_13_gpio_pin {
				pinctrl-single,pins = <0x24 0x2f>;
				linux,phandle = <0x1a>;
				phandle = <0x1a>;
			};

			pinmux_P8_13_gpio_pu_pin {
				pinctrl-single,pins = <0x24 0x37>;
				linux,phandle = <0x1b>;
				phandle = <0x1b>;
			};

			pinmux_P8_13_gpio_pd_pin {
				pinctrl-single,pins = <0x24 0x27>;
				linux,phandle = <0x1c>;
				phandle = <0x1c>;
			};

			pinmux_P8_13_gpio_input_pin {
				pinctrl-single,pins = <0x24 0x2f>;
				linux,phandle = <0x1d>;
				phandle = <0x1d>;
			};

			pinmux_P8_13_pwm_pin {
				pinctrl-single,pins = <0x24 0x24>;
				linux,phandle = <0x1e>;
				phandle = <0x1e>;
			};

			pinmux_P8_19_default_pin {
				pinctrl-single,pins = <0x20 0x27>;
				linux,phandle = <0x1f>;
				phandle = <0x1f>;
			};

			pinmux_P8_19_gpio_pin {
				pinctrl-single,pins = <0x20 0x2f>;
				linux,phandle = <0x20>;
				phandle = <0x20>;
			};

			pinmux_P8_19_gpio_pu_pin {
				pinctrl-single,pins = <0x20 0x37>;
				linux,phandle = <0x21>;
				phandle = <0x21>;
			};

			pinmux_P8_19_gpio_pd_pin {
				pinctrl-single,pins = <0x20 0x27>;
				linux,phandle = <0x22>;
				phandle = <0x22>;
			};

			pinmux_P8_19_gpio_input_pin {
				pinctrl-single,pins = <0x20 0x2f>;
				linux,phandle = <0x23>;
				phandle = <0x23>;
			};

			pinmux_P8_19_pwm_pin {
				pinctrl-single,pins = <0x20 0x24>;
				linux,phandle = <0x24>;
				phandle = <0x24>;
			};

			pinmux_P8_27_default_pin {
				pinctrl-single,pins = <0xe0 0x27>;
				linux,phandle = <0x25>;
				phandle = <0x25>;
			};

			pinmux_P8_27_gpio_pin {
				pinctrl-single,pins = <0xe0 0x2f>;
				linux,phandle = <0x26>;
				phandle = <0x26>;
			};

			pinmux_P8_27_gpio_pu_pin {
				pinctrl-single,pins = <0xe0 0x37>;
				linux,phandle = <0x27>;
				phandle = <0x27>;
			};

			pinmux_P8_27_gpio_pd_pin {
				pinctrl-single,pins = <0xe0 0x27>;
				linux,phandle = <0x28>;
				phandle = <0x28>;
			};

			pinmux_P8_27_gpio_input_pin {
				pinctrl-single,pins = <0xe0 0x2f>;
				linux,phandle = <0x29>;
				phandle = <0x29>;
			};

			pinmux_P8_27_pruout_pin {
				pinctrl-single,pins = <0xe0 0x25>;
				linux,phandle = <0x2a>;
				phandle = <0x2a>;
			};

			pinmux_P8_27_pruin_pin {
				pinctrl-single,pins = <0xe0 0x2e>;
				linux,phandle = <0x2b>;
				phandle = <0x2b>;
			};

			pinmux_P8_28_default_pin {
				pinctrl-single,pins = <0xe8 0x27>;
				linux,phandle = <0x2c>;
				phandle = <0x2c>;
			};

			pinmux_P8_28_gpio_pin {
				pinctrl-single,pins = <0xe8 0x2f>;
				linux,phandle = <0x2d>;
				phandle = <0x2d>;
			};

			pinmux_P8_28_gpio_pu_pin {
				pinctrl-single,pins = <0xe8 0x37>;
				linux,phandle = <0x2e>;
				phandle = <0x2e>;
			};

			pinmux_P8_28_gpio_pd_pin {
				pinctrl-single,pins = <0xe8 0x27>;
				linux,phandle = <0x2f>;
				phandle = <0x2f>;
			};

			pinmux_P8_28_gpio_input_pin {
				pinctrl-single,pins = <0xe8 0x2f>;
				linux,phandle = <0x30>;
				phandle = <0x30>;
			};

			pinmux_P8_28_pruout_pin {
				pinctrl-single,pins = <0xe8 0x25>;
				linux,phandle = <0x31>;
				phandle = <0x31>;
			};

			pinmux_P8_28_pruin_pin {
				pinctrl-single,pins = <0xe8 0x2e>;
				linux,phandle = <0x32>;
				phandle = <0x32>;
			};

			pinmux_P8_29_default_pin {
				pinctrl-single,pins = <0xe4 0x27>;
				linux,phandle = <0x33>;
				phandle = <0x33>;
			};

			pinmux_P8_29_gpio_pin {
				pinctrl-single,pins = <0xe4 0x2f>;
				linux,phandle = <0x34>;
				phandle = <0x34>;
			};

			pinmux_P8_29_gpio_pu_pin {
				pinctrl-single,pins = <0xe4 0x37>;
				linux,phandle = <0x35>;
				phandle = <0x35>;
			};

			pinmux_P8_29_gpio_pd_pin {
				pinctrl-single,pins = <0xe4 0x27>;
				linux,phandle = <0x36>;
				phandle = <0x36>;
			};

			pinmux_P8_29_gpio_input_pin {
				pinctrl-single,pins = <0xe4 0x2f>;
				linux,phandle = <0x37>;
				phandle = <0x37>;
			};

			pinmux_P8_29_pruout_pin {
				pinctrl-single,pins = <0xe4 0x25>;
				linux,phandle = <0x38>;
				phandle = <0x38>;
			};

			pinmux_P8_29_pruin_pin {
				pinctrl-single,pins = <0xe4 0x2e>;
				linux,phandle = <0x39>;
				phandle = <0x39>;
			};

			pinmux_P8_30_default_pin {
				pinctrl-single,pins = <0xec 0x27>;
				linux,phandle = <0x3a>;
				phandle = <0x3a>;
			};

			pinmux_P8_30_gpio_pin {
				pinctrl-single,pins = <0xec 0x2f>;
				linux,phandle = <0x3b>;
				phandle = <0x3b>;
			};

			pinmux_P8_30_gpio_pu_pin {
				pinctrl-single,pins = <0xec 0x37>;
				linux,phandle = <0x3c>;
				phandle = <0x3c>;
			};

			pinmux_P8_30_gpio_pd_pin {
				pinctrl-single,pins = <0xec 0x27>;
				linux,phandle = <0x3d>;
				phandle = <0x3d>;
			};

			pinmux_P8_30_gpio_input_pin {
				pinctrl-single,pins = <0xec 0x2f>;
				linux,phandle = <0x3e>;
				phandle = <0x3e>;
			};

			pinmux_P8_30_pruout_pin {
				pinctrl-single,pins = <0xec 0x25>;
				linux,phandle = <0x3f>;
				phandle = <0x3f>;
			};

			pinmux_P8_30_pruin_pin {
				pinctrl-single,pins = <0xec 0x2e>;
				linux,phandle = <0x40>;
				phandle = <0x40>;
			};

			pinmux_P8_31_default_pin {
				pinctrl-single,pins = <0xd8 0x27>;
				linux,phandle = <0x41>;
				phandle = <0x41>;
			};

			pinmux_P8_31_gpio_pin {
				pinctrl-single,pins = <0xd8 0x2f>;
				linux,phandle = <0x42>;
				phandle = <0x42>;
			};

			pinmux_P8_31_gpio_pu_pin {
				pinctrl-single,pins = <0xd8 0x37>;
				linux,phandle = <0x43>;
				phandle = <0x43>;
			};

			pinmux_P8_31_gpio_pd_pin {
				pinctrl-single,pins = <0xd8 0x27>;
				linux,phandle = <0x44>;
				phandle = <0x44>;
			};

			pinmux_P8_31_gpio_input_pin {
				pinctrl-single,pins = <0xd8 0x2f>;
				linux,phandle = <0x45>;
				phandle = <0x45>;
			};

			pinmux_P8_31_qep_pin {
				pinctrl-single,pins = <0xd8 0x32>;
				linux,phandle = <0x47>;
				phandle = <0x47>;
			};

			pinmux_P8_31_uart_pin {
				pinctrl-single,pins = <0xd8 0x34>;
				linux,phandle = <0x46>;
				phandle = <0x46>;
			};

			pinmux_P8_32_default_pin {
				pinctrl-single,pins = <0xdc 0x27>;
				linux,phandle = <0x48>;
				phandle = <0x48>;
			};

			pinmux_P8_32_gpio_pin {
				pinctrl-single,pins = <0xdc 0x2f>;
				linux,phandle = <0x49>;
				phandle = <0x49>;
			};

			pinmux_P8_32_gpio_pu_pin {
				pinctrl-single,pins = <0xdc 0x37>;
				linux,phandle = <0x4a>;
				phandle = <0x4a>;
			};

			pinmux_P8_32_gpio_pd_pin {
				pinctrl-single,pins = <0xdc 0x27>;
				linux,phandle = <0x4b>;
				phandle = <0x4b>;
			};

			pinmux_P8_32_gpio_input_pin {
				pinctrl-single,pins = <0xdc 0x2f>;
				linux,phandle = <0x4c>;
				phandle = <0x4c>;
			};

			pinmux_P8_32_qep_pin {
				pinctrl-single,pins = <0xdc 0x32>;
				linux,phandle = <0x4d>;
				phandle = <0x4d>;
			};

			pinmux_P8_33_default_pin {
				pinctrl-single,pins = <0xd4 0x27>;
				linux,phandle = <0x4e>;
				phandle = <0x4e>;
			};

			pinmux_P8_33_gpio_pin {
				pinctrl-single,pins = <0xd4 0x2f>;
				linux,phandle = <0x4f>;
				phandle = <0x4f>;
			};

			pinmux_P8_33_gpio_pu_pin {
				pinctrl-single,pins = <0xd4 0x37>;
				linux,phandle = <0x50>;
				phandle = <0x50>;
			};

			pinmux_P8_33_gpio_pd_pin {
				pinctrl-single,pins = <0xd4 0x27>;
				linux,phandle = <0x51>;
				phandle = <0x51>;
			};

			pinmux_P8_33_gpio_input_pin {
				pinctrl-single,pins = <0xd4 0x2f>;
				linux,phandle = <0x52>;
				phandle = <0x52>;
			};

			pinmux_P8_33_qep_pin {
				pinctrl-single,pins = <0xd4 0x32>;
				linux,phandle = <0x53>;
				phandle = <0x53>;
			};

			pinmux_P8_34_default_pin {
				pinctrl-single,pins = <0xcc 0x27>;
				linux,phandle = <0x54>;
				phandle = <0x54>;
			};

			pinmux_P8_34_gpio_pin {
				pinctrl-single,pins = <0xcc 0x2f>;
				linux,phandle = <0x55>;
				phandle = <0x55>;
			};

			pinmux_P8_34_gpio_pu_pin {
				pinctrl-single,pins = <0xcc 0x37>;
				linux,phandle = <0x56>;
				phandle = <0x56>;
			};

			pinmux_P8_34_gpio_pd_pin {
				pinctrl-single,pins = <0xcc 0x27>;
				linux,phandle = <0x57>;
				phandle = <0x57>;
			};

			pinmux_P8_34_gpio_input_pin {
				pinctrl-single,pins = <0xcc 0x2f>;
				linux,phandle = <0x58>;
				phandle = <0x58>;
			};

			pinmux_P8_34_pwm_pin {
				pinctrl-single,pins = <0xcc 0x22>;
				linux,phandle = <0x59>;
				phandle = <0x59>;
			};

			pinmux_P8_35_default_pin {
				pinctrl-single,pins = <0xd0 0x27>;
				linux,phandle = <0x5a>;
				phandle = <0x5a>;
			};

			pinmux_P8_35_gpio_pin {
				pinctrl-single,pins = <0xd0 0x2f>;
				linux,phandle = <0x5b>;
				phandle = <0x5b>;
			};

			pinmux_P8_35_gpio_pu_pin {
				pinctrl-single,pins = <0xd0 0x37>;
				linux,phandle = <0x5c>;
				phandle = <0x5c>;
			};

			pinmux_P8_35_gpio_pd_pin {
				pinctrl-single,pins = <0xd0 0x27>;
				linux,phandle = <0x5d>;
				phandle = <0x5d>;
			};

			pinmux_P8_35_gpio_input_pin {
				pinctrl-single,pins = <0xd0 0x2f>;
				linux,phandle = <0x5e>;
				phandle = <0x5e>;
			};

			pinmux_P8_35_qep_pin {
				pinctrl-single,pins = <0xd0 0x32>;
				linux,phandle = <0x5f>;
				phandle = <0x5f>;
			};

			pinmux_P8_36_default_pin {
				pinctrl-single,pins = <0xc8 0x27>;
				linux,phandle = <0x60>;
				phandle = <0x60>;
			};

			pinmux_P8_36_gpio_pin {
				pinctrl-single,pins = <0xc8 0x2f>;
				linux,phandle = <0x61>;
				phandle = <0x61>;
			};

			pinmux_P8_36_gpio_pu_pin {
				pinctrl-single,pins = <0xc8 0x37>;
				linux,phandle = <0x62>;
				phandle = <0x62>;
			};

			pinmux_P8_36_gpio_pd_pin {
				pinctrl-single,pins = <0xc8 0x27>;
				linux,phandle = <0x63>;
				phandle = <0x63>;
			};

			pinmux_P8_36_gpio_input_pin {
				pinctrl-single,pins = <0xc8 0x2f>;
				linux,phandle = <0x64>;
				phandle = <0x64>;
			};

			pinmux_P8_36_pwm_pin {
				pinctrl-single,pins = <0xc8 0x22>;
				linux,phandle = <0x65>;
				phandle = <0x65>;
			};

			pinmux_P8_39_default_pin {
				pinctrl-single,pins = <0xb8 0x27>;
				linux,phandle = <0x66>;
				phandle = <0x66>;
			};

			pinmux_P8_39_gpio_pin {
				pinctrl-single,pins = <0xb8 0x2f>;
				linux,phandle = <0x67>;
				phandle = <0x67>;
			};

			pinmux_P8_39_gpio_pu_pin {
				pinctrl-single,pins = <0xb8 0x37>;
				linux,phandle = <0x68>;
				phandle = <0x68>;
			};

			pinmux_P8_39_gpio_pd_pin {
				pinctrl-single,pins = <0xb8 0x27>;
				linux,phandle = <0x69>;
				phandle = <0x69>;
			};

			pinmux_P8_39_gpio_input_pin {
				pinctrl-single,pins = <0xb8 0x2f>;
				linux,phandle = <0x6a>;
				phandle = <0x6a>;
			};

			pinmux_P8_39_qep_pin {
				pinctrl-single,pins = <0xb8 0x33>;
				linux,phandle = <0x6b>;
				phandle = <0x6b>;
			};

			pinmux_P8_39_pruout_pin {
				pinctrl-single,pins = <0xb8 0x25>;
				linux,phandle = <0x6c>;
				phandle = <0x6c>;
			};

			pinmux_P8_39_pruin_pin {
				pinctrl-single,pins = <0xb8 0x2e>;
				linux,phandle = <0x6d>;
				phandle = <0x6d>;
			};

			pinmux_P8_40_default_pin {
				pinctrl-single,pins = <0xbc 0x27>;
				linux,phandle = <0x6e>;
				phandle = <0x6e>;
			};

			pinmux_P8_40_gpio_pin {
				pinctrl-single,pins = <0xbc 0x2f>;
				linux,phandle = <0x6f>;
				phandle = <0x6f>;
			};

			pinmux_P8_40_gpio_pu_pin {
				pinctrl-single,pins = <0xbc 0x37>;
				linux,phandle = <0x70>;
				phandle = <0x70>;
			};

			pinmux_P8_40_gpio_pd_pin {
				pinctrl-single,pins = <0xbc 0x27>;
				linux,phandle = <0x71>;
				phandle = <0x71>;
			};

			pinmux_P8_40_gpio_input_pin {
				pinctrl-single,pins = <0xbc 0x2f>;
				linux,phandle = <0x72>;
				phandle = <0x72>;
			};

			pinmux_P8_40_qep_pin {
				pinctrl-single,pins = <0xbc 0x33>;
				linux,phandle = <0x73>;
				phandle = <0x73>;
			};

			pinmux_P8_40_pruout_pin {
				pinctrl-single,pins = <0xbc 0x25>;
				linux,phandle = <0x74>;
				phandle = <0x74>;
			};

			pinmux_P8_40_pruin_pin {
				pinctrl-single,pins = <0xbc 0x2e>;
				linux,phandle = <0x75>;
				phandle = <0x75>;
			};

			pinmux_P8_41_default_pin {
				pinctrl-single,pins = <0xb0 0x27>;
				linux,phandle = <0x76>;
				phandle = <0x76>;
			};

			pinmux_P8_41_gpio_pin {
				pinctrl-single,pins = <0xb0 0x2f>;
				linux,phandle = <0x77>;
				phandle = <0x77>;
			};

			pinmux_P8_41_gpio_pu_pin {
				pinctrl-single,pins = <0xb0 0x37>;
				linux,phandle = <0x78>;
				phandle = <0x78>;
			};

			pinmux_P8_41_gpio_pd_pin {
				pinctrl-single,pins = <0xb0 0x27>;
				linux,phandle = <0x79>;
				phandle = <0x79>;
			};

			pinmux_P8_41_gpio_input_pin {
				pinctrl-single,pins = <0xb0 0x2f>;
				linux,phandle = <0x7a>;
				phandle = <0x7a>;
			};

			pinmux_P8_41_qep_pin {
				pinctrl-single,pins = <0xb0 0x33>;
				linux,phandle = <0x7b>;
				phandle = <0x7b>;
			};

			pinmux_P8_41_pruout_pin {
				pinctrl-single,pins = <0xb0 0x25>;
				linux,phandle = <0x7c>;
				phandle = <0x7c>;
			};

			pinmux_P8_41_pruin_pin {
				pinctrl-single,pins = <0xb0 0x2e>;
				linux,phandle = <0x7d>;
				phandle = <0x7d>;
			};

			pinmux_P8_42_default_pin {
				pinctrl-single,pins = <0xb4 0x27>;
				linux,phandle = <0x7e>;
				phandle = <0x7e>;
			};

			pinmux_P8_42_gpio_pin {
				pinctrl-single,pins = <0xb4 0x2f>;
				linux,phandle = <0x7f>;
				phandle = <0x7f>;
			};

			pinmux_P8_42_gpio_pu_pin {
				pinctrl-single,pins = <0xb4 0x37>;
				linux,phandle = <0x80>;
				phandle = <0x80>;
			};

			pinmux_P8_42_gpio_pd_pin {
				pinctrl-single,pins = <0xb4 0x27>;
				linux,phandle = <0x81>;
				phandle = <0x81>;
			};

			pinmux_P8_42_gpio_input_pin {
				pinctrl-single,pins = <0xb4 0x2f>;
				linux,phandle = <0x82>;
				phandle = <0x82>;
			};

			pinmux_P8_42_qep_pin {
				pinctrl-single,pins = <0xb4 0x33>;
				linux,phandle = <0x83>;
				phandle = <0x83>;
			};

			pinmux_P8_42_pruout_pin {
				pinctrl-single,pins = <0xb4 0x25>;
				linux,phandle = <0x84>;
				phandle = <0x84>;
			};

			pinmux_P8_42_pruin_pin {
				pinctrl-single,pins = <0xb4 0x2e>;
				linux,phandle = <0x85>;
				phandle = <0x85>;
			};

			pinmux_P8_43_default_pin {
				pinctrl-single,pins = <0xa8 0x27>;
				linux,phandle = <0x86>;
				phandle = <0x86>;
			};

			pinmux_P8_43_gpio_pin {
				pinctrl-single,pins = <0xa8 0x2f>;
				linux,phandle = <0x87>;
				phandle = <0x87>;
			};

			pinmux_P8_43_gpio_pu_pin {
				pinctrl-single,pins = <0xa8 0x37>;
				linux,phandle = <0x88>;
				phandle = <0x88>;
			};

			pinmux_P8_43_gpio_pd_pin {
				pinctrl-single,pins = <0xa8 0x27>;
				linux,phandle = <0x89>;
				phandle = <0x89>;
			};

			pinmux_P8_43_gpio_input_pin {
				pinctrl-single,pins = <0xa8 0x2f>;
				linux,phandle = <0x8a>;
				phandle = <0x8a>;
			};

			pinmux_P8_43_pwm_pin {
				pinctrl-single,pins = <0xa8 0x23>;
				linux,phandle = <0x8b>;
				phandle = <0x8b>;
			};

			pinmux_P8_43_pruout_pin {
				pinctrl-single,pins = <0xa8 0x25>;
				linux,phandle = <0x8c>;
				phandle = <0x8c>;
			};

			pinmux_P8_43_pruin_pin {
				pinctrl-single,pins = <0xa8 0x2e>;
				linux,phandle = <0x8d>;
				phandle = <0x8d>;
			};

			pinmux_P8_44_default_pin {
				pinctrl-single,pins = <0xac 0x27>;
				linux,phandle = <0x8e>;
				phandle = <0x8e>;
			};

			pinmux_P8_44_gpio_pin {
				pinctrl-single,pins = <0xac 0x2f>;
				linux,phandle = <0x8f>;
				phandle = <0x8f>;
			};

			pinmux_P8_44_gpio_pu_pin {
				pinctrl-single,pins = <0xac 0x37>;
				linux,phandle = <0x90>;
				phandle = <0x90>;
			};

			pinmux_P8_44_gpio_pd_pin {
				pinctrl-single,pins = <0xac 0x27>;
				linux,phandle = <0x91>;
				phandle = <0x91>;
			};

			pinmux_P8_44_gpio_input_pin {
				pinctrl-single,pins = <0xac 0x2f>;
				linux,phandle = <0x92>;
				phandle = <0x92>;
			};

			pinmux_P8_44_pwm_pin {
				pinctrl-single,pins = <0xac 0x23>;
				linux,phandle = <0x93>;
				phandle = <0x93>;
			};

			pinmux_P8_44_pruout_pin {
				pinctrl-single,pins = <0xac 0x25>;
				linux,phandle = <0x94>;
				phandle = <0x94>;
			};

			pinmux_P8_44_pruin_pin {
				pinctrl-single,pins = <0xac 0x2e>;
				linux,phandle = <0x95>;
				phandle = <0x95>;
			};

			pinmux_P8_45_default_pin {
				pinctrl-single,pins = <0xa0 0x27>;
				linux,phandle = <0x96>;
				phandle = <0x96>;
			};

			pinmux_P8_45_gpio_pin {
				pinctrl-single,pins = <0xa0 0x2f>;
				linux,phandle = <0x97>;
				phandle = <0x97>;
			};

			pinmux_P8_45_gpio_pu_pin {
				pinctrl-single,pins = <0xa0 0x37>;
				linux,phandle = <0x98>;
				phandle = <0x98>;
			};

			pinmux_P8_45_gpio_pd_pin {
				pinctrl-single,pins = <0xa0 0x27>;
				linux,phandle = <0x99>;
				phandle = <0x99>;
			};

			pinmux_P8_45_gpio_input_pin {
				pinctrl-single,pins = <0xa0 0x2f>;
				linux,phandle = <0x9a>;
				phandle = <0x9a>;
			};

			pinmux_P8_45_pwm_pin {
				pinctrl-single,pins = <0xa0 0x23>;
				linux,phandle = <0x9b>;
				phandle = <0x9b>;
			};

			pinmux_P8_45_pruout_pin {
				pinctrl-single,pins = <0xa0 0x25>;
				linux,phandle = <0x9c>;
				phandle = <0x9c>;
			};

			pinmux_P8_45_pruin_pin {
				pinctrl-single,pins = <0xa0 0x2e>;
				linux,phandle = <0x9d>;
				phandle = <0x9d>;
			};

			pinmux_P8_46_default_pin {
				pinctrl-single,pins = <0xa4 0x27>;
				linux,phandle = <0x9e>;
				phandle = <0x9e>;
			};

			pinmux_P8_46_gpio_pin {
				pinctrl-single,pins = <0xa4 0x2f>;
				linux,phandle = <0x9f>;
				phandle = <0x9f>;
			};

			pinmux_P8_46_gpio_pu_pin {
				pinctrl-single,pins = <0xa4 0x37>;
				linux,phandle = <0xa0>;
				phandle = <0xa0>;
			};

			pinmux_P8_46_gpio_pd_pin {
				pinctrl-single,pins = <0xa4 0x27>;
				linux,phandle = <0xa1>;
				phandle = <0xa1>;
			};

			pinmux_P8_46_gpio_input_pin {
				pinctrl-single,pins = <0xa4 0x2f>;
				linux,phandle = <0xa2>;
				phandle = <0xa2>;
			};

			pinmux_P8_46_pwm_pin {
				pinctrl-single,pins = <0xa4 0x23>;
				linux,phandle = <0xa3>;
				phandle = <0xa3>;
			};

			pinmux_P8_46_pruout_pin {
				pinctrl-single,pins = <0xa4 0x25>;
				linux,phandle = <0xa4>;
				phandle = <0xa4>;
			};

			pinmux_P8_46_pruin_pin {
				pinctrl-single,pins = <0xa4 0x2e>;
				linux,phandle = <0xa5>;
				phandle = <0xa5>;
			};

			pinmux_P9_11_default_pin {
				pinctrl-single,pins = <0x70 0x27>;
				linux,phandle = <0xa6>;
				phandle = <0xa6>;
			};

			pinmux_P9_11_gpio_pin {
				pinctrl-single,pins = <0x70 0x2f>;
				linux,phandle = <0xa7>;
				phandle = <0xa7>;
			};

			pinmux_P9_11_gpio_pu_pin {
				pinctrl-single,pins = <0x70 0x37>;
				linux,phandle = <0xa8>;
				phandle = <0xa8>;
			};

			pinmux_P9_11_gpio_pd_pin {
				pinctrl-single,pins = <0x70 0x27>;
				linux,phandle = <0xa9>;
				phandle = <0xa9>;
			};

			pinmux_P9_11_gpio_input_pin {
				pinctrl-single,pins = <0x70 0x2f>;
				linux,phandle = <0xaa>;
				phandle = <0xaa>;
			};

			pinmux_P9_11_uart_pin {
				pinctrl-single,pins = <0x70 0x36>;
				linux,phandle = <0xab>;
				phandle = <0xab>;
			};

			pinmux_P9_13_default_pin {
				pinctrl-single,pins = <0x74 0x27>;
				linux,phandle = <0xac>;
				phandle = <0xac>;
			};

			pinmux_P9_13_gpio_pin {
				pinctrl-single,pins = <0x74 0x2f>;
				linux,phandle = <0xad>;
				phandle = <0xad>;
			};

			pinmux_P9_13_gpio_pu_pin {
				pinctrl-single,pins = <0x74 0x37>;
				linux,phandle = <0xae>;
				phandle = <0xae>;
			};

			pinmux_P9_13_gpio_pd_pin {
				pinctrl-single,pins = <0x74 0x27>;
				linux,phandle = <0xaf>;
				phandle = <0xaf>;
			};

			pinmux_P9_13_gpio_input_pin {
				pinctrl-single,pins = <0x74 0x2f>;
				linux,phandle = <0xb0>;
				phandle = <0xb0>;
			};

			pinmux_P9_13_uart_pin {
				pinctrl-single,pins = <0x74 0x36>;
				linux,phandle = <0xb1>;
				phandle = <0xb1>;
			};

			pinmux_P9_14_default_pin {
				pinctrl-single,pins = <0x48 0x27>;
				linux,phandle = <0xb2>;
				phandle = <0xb2>;
			};

			pinmux_P9_14_gpio_pin {
				pinctrl-single,pins = <0x48 0x2f>;
				linux,phandle = <0xb3>;
				phandle = <0xb3>;
			};

			pinmux_P9_14_gpio_pu_pin {
				pinctrl-single,pins = <0x48 0x37>;
				linux,phandle = <0xb4>;
				phandle = <0xb4>;
			};

			pinmux_P9_14_gpio_pd_pin {
				pinctrl-single,pins = <0x48 0x27>;
				linux,phandle = <0xb5>;
				phandle = <0xb5>;
			};

			pinmux_P9_14_gpio_input_pin {
				pinctrl-single,pins = <0x48 0x2f>;
				linux,phandle = <0xb6>;
				phandle = <0xb6>;
			};

			pinmux_P9_14_pwm_pin {
				pinctrl-single,pins = <0x48 0x26>;
				linux,phandle = <0xb7>;
				phandle = <0xb7>;
			};

			pinmux_P9_15_default_pin {
				pinctrl-single,pins = <0x40 0x27>;
				linux,phandle = <0xb8>;
				phandle = <0xb8>;
			};

			pinmux_P9_15_gpio_pin {
				pinctrl-single,pins = <0x40 0x2f>;
				linux,phandle = <0xb9>;
				phandle = <0xb9>;
			};

			pinmux_P9_15_gpio_pu_pin {
				pinctrl-single,pins = <0x40 0x37>;
				linux,phandle = <0xba>;
				phandle = <0xba>;
			};

			pinmux_P9_15_gpio_pd_pin {
				pinctrl-single,pins = <0x40 0x27>;
				linux,phandle = <0xbb>;
				phandle = <0xbb>;
			};

			pinmux_P9_15_gpio_input_pin {
				pinctrl-single,pins = <0x40 0x2f>;
				linux,phandle = <0xbc>;
				phandle = <0xbc>;
			};

			pinmux_P9_15_pwm_pin {
				pinctrl-single,pins = <0x40 0x26>;
				linux,phandle = <0xbd>;
				phandle = <0xbd>;
			};

			pinmux_P9_16_default_pin {
				pinctrl-single,pins = <0x4c 0x27>;
				linux,phandle = <0xbe>;
				phandle = <0xbe>;
			};

			pinmux_P9_16_gpio_pin {
				pinctrl-single,pins = <0x4c 0x2f>;
				linux,phandle = <0xbf>;
				phandle = <0xbf>;
			};

			pinmux_P9_16_gpio_pu_pin {
				pinctrl-single,pins = <0x4c 0x37>;
				linux,phandle = <0xc0>;
				phandle = <0xc0>;
			};

			pinmux_P9_16_gpio_pd_pin {
				pinctrl-single,pins = <0x4c 0x27>;
				linux,phandle = <0xc1>;
				phandle = <0xc1>;
			};

			pinmux_P9_16_gpio_input_pin {
				pinctrl-single,pins = <0x4c 0x2f>;
				linux,phandle = <0xc2>;
				phandle = <0xc2>;
			};

			pinmux_P9_16_pwm_pin {
				pinctrl-single,pins = <0x4c 0x26>;
				linux,phandle = <0xc3>;
				phandle = <0xc3>;
			};

			pinmux_P9_17_default_pin {
				pinctrl-single,pins = <0x15c 0x32>;
				linux,phandle = <0xc4>;
				phandle = <0xc4>;
			};

			pinmux_P9_17_gpio_pin {
				pinctrl-single,pins = <0x15c 0x2f>;
				linux,phandle = <0xc5>;
				phandle = <0xc5>;
			};

			pinmux_P9_17_gpio_pu_pin {
				pinctrl-single,pins = <0x15c 0x37>;
				linux,phandle = <0xc6>;
				phandle = <0xc6>;
			};

			pinmux_P9_17_gpio_pd_pin {
				pinctrl-single,pins = <0x15c 0x27>;
				linux,phandle = <0xc7>;
				phandle = <0xc7>;
			};

			pinmux_P9_17_gpio_input_pin {
				pinctrl-single,pins = <0x15c 0x2f>;
				linux,phandle = <0xc8>;
				phandle = <0xc8>;
			};

			pinmux_P9_17_spi_cs_pin {
				pinctrl-single,pins = <0x15c 0x30>;
				linux,phandle = <0xc9>;
				phandle = <0xc9>;
			};

			pinmux_P9_17_i2c_pin {
				pinctrl-single,pins = <0x15c 0x32>;
				linux,phandle = <0xca>;
				phandle = <0xca>;
			};

			pinmux_P9_17_pwm_pin {
				pinctrl-single,pins = <0x15c 0x23>;
				linux,phandle = <0xcb>;
				phandle = <0xcb>;
			};

			pinmux_P9_17_pru_uart_pin {
				pinctrl-single,pins = <0x15c 0x34>;
				linux,phandle = <0xcc>;
				phandle = <0xcc>;
			};

			pinmux_P9_18_default_pin {
				pinctrl-single,pins = <0x158 0x32>;
				linux,phandle = <0xcd>;
				phandle = <0xcd>;
			};

			pinmux_P9_18_gpio_pin {
				pinctrl-single,pins = <0x158 0x2f>;
				linux,phandle = <0xce>;
				phandle = <0xce>;
			};

			pinmux_P9_18_gpio_pu_pin {
				pinctrl-single,pins = <0x158 0x37>;
				linux,phandle = <0xcf>;
				phandle = <0xcf>;
			};

			pinmux_P9_18_gpio_pd_pin {
				pinctrl-single,pins = <0x158 0x27>;
				linux,phandle = <0xd0>;
				phandle = <0xd0>;
			};

			pinmux_P9_18_gpio_input_pin {
				pinctrl-single,pins = <0x158 0x2f>;
				linux,phandle = <0xd1>;
				phandle = <0xd1>;
			};

			pinmux_P9_18_spi_pin {
				pinctrl-single,pins = <0x158 0x30>;
				linux,phandle = <0xd2>;
				phandle = <0xd2>;
			};

			pinmux_P9_18_i2c_pin {
				pinctrl-single,pins = <0x158 0x32>;
				linux,phandle = <0xd3>;
				phandle = <0xd3>;
			};

			pinmux_P9_18_pwm_pin {
				pinctrl-single,pins = <0x158 0x23>;
				linux,phandle = <0xd4>;
				phandle = <0xd4>;
			};

			pinmux_P9_18_pru_uart_pin {
				pinctrl-single,pins = <0x158 0x34>;
				linux,phandle = <0xd5>;
				phandle = <0xd5>;
			};

			pinmux_P9_19_default_pin {
				pinctrl-single,pins = <0x17c 0x2f>;
				linux,phandle = <0xd6>;
				phandle = <0xd6>;
			};

			pinmux_P9_19_gpio_pin {
				pinctrl-single,pins = <0x17c 0x2f>;
				linux,phandle = <0xd7>;
				phandle = <0xd7>;
			};

			pinmux_P9_19_gpio_pu_pin {
				pinctrl-single,pins = <0x17c 0x37>;
				linux,phandle = <0xd8>;
				phandle = <0xd8>;
			};

			pinmux_P9_19_gpio_pd_pin {
				pinctrl-single,pins = <0x17c 0x27>;
				linux,phandle = <0xd9>;
				phandle = <0xd9>;
			};

			pinmux_P9_19_gpio_input_pin {
				pinctrl-single,pins = <0x17c 0x2f>;
				linux,phandle = <0xda>;
				phandle = <0xda>;
			};

			pinmux_P9_19_timer_pin {
				pinctrl-single,pins = <0x17c 0x31>;
				linux,phandle = <0xdb>;
				phandle = <0xdb>;
			};

			pinmux_P9_19_can_pin {
				pinctrl-single,pins = <0x17c 0x32>;
				linux,phandle = <0xdc>;
				phandle = <0xdc>;
			};

			pinmux_P9_19_i2c_pin {
				pinctrl-single,pins = <0x17c 0x33>;
				linux,phandle = <0xdd>;
				phandle = <0xdd>;
			};

			pinmux_P9_19_spi_cs_pin {
				pinctrl-single,pins = <0x17c 0x34>;
				linux,phandle = <0xde>;
				phandle = <0xde>;
			};

			pinmux_P9_19_pru_uart_pin {
				pinctrl-single,pins = <0x17c 0x35>;
				linux,phandle = <0xdf>;
				phandle = <0xdf>;
			};

			pinmux_P9_20_default_pin {
				pinctrl-single,pins = <0x178 0xf>;
				linux,phandle = <0xe0>;
				phandle = <0xe0>;
			};

			pinmux_P9_20_gpio_pin {
				pinctrl-single,pins = <0x178 0x2f>;
				linux,phandle = <0xe1>;
				phandle = <0xe1>;
			};

			pinmux_P9_20_gpio_pu_pin {
				pinctrl-single,pins = <0x178 0x37>;
				linux,phandle = <0xe2>;
				phandle = <0xe2>;
			};

			pinmux_P9_20_gpio_pd_pin {
				pinctrl-single,pins = <0x178 0x27>;
				linux,phandle = <0xe3>;
				phandle = <0xe3>;
			};

			pinmux_P9_20_gpio_input_pin {
				pinctrl-single,pins = <0x178 0x2f>;
				linux,phandle = <0xe4>;
				phandle = <0xe4>;
			};

			pinmux_P9_20_timer_pin {
				pinctrl-single,pins = <0x178 0x31>;
				linux,phandle = <0xe5>;
				phandle = <0xe5>;
			};

			pinmux_P9_20_can_pin {
				pinctrl-single,pins = <0x178 0x12>;
				linux,phandle = <0xe6>;
				phandle = <0xe6>;
			};

			pinmux_P9_20_i2c_pin {
				pinctrl-single,pins = <0x178 0x33>;
				linux,phandle = <0xe7>;
				phandle = <0xe7>;
			};

			pinmux_P9_20_spi_cs_pin {
				pinctrl-single,pins = <0x178 0x34>;
				linux,phandle = <0xe8>;
				phandle = <0xe8>;
			};

			pinmux_P9_20_pru_uart_pin {
				pinctrl-single,pins = <0x178 0x35>;
				linux,phandle = <0xe9>;
				phandle = <0xe9>;
			};

			pinmux_P9_21_default_pin {
				pinctrl-single,pins = <0x154 0x2f>;
				linux,phandle = <0xea>;
				phandle = <0xea>;
			};

			pinmux_P9_21_gpio_pin {
				pinctrl-single,pins = <0x154 0x2f>;
				linux,phandle = <0xeb>;
				phandle = <0xeb>;
			};

			pinmux_P9_21_gpio_pu_pin {
				pinctrl-single,pins = <0x154 0x37>;
				linux,phandle = <0xec>;
				phandle = <0xec>;
			};

			pinmux_P9_21_gpio_pd_pin {
				pinctrl-single,pins = <0x154 0x27>;
				linux,phandle = <0xed>;
				phandle = <0xed>;
			};

			pinmux_P9_21_gpio_input_pin {
				pinctrl-single,pins = <0x154 0x2f>;
				linux,phandle = <0xee>;
				phandle = <0xee>;
			};

			pinmux_P9_21_spi_pin {
				pinctrl-single,pins = <0x154 0x30>;
				linux,phandle = <0xef>;
				phandle = <0xef>;
			};

			pinmux_P9_21_uart_pin {
				pinctrl-single,pins = <0x154 0x31>;
				linux,phandle = <0xf0>;
				phandle = <0xf0>;
			};

			pinmux_P9_21_i2c_pin {
				pinctrl-single,pins = <0x154 0x32>;
				linux,phandle = <0xf1>;
				phandle = <0xf1>;
			};

			pinmux_P9_21_pwm_pin {
				pinctrl-single,pins = <0x154 0x23>;
				linux,phandle = <0xf2>;
				phandle = <0xf2>;
			};

			pinmux_P9_21_pru_uart_pin {
				pinctrl-single,pins = <0x154 0x34>;
				linux,phandle = <0xf3>;
				phandle = <0xf3>;
			};

			pinmux_P9_22_default_pin {
				pinctrl-single,pins = <0x150 0x2f>;
				linux,phandle = <0xf4>;
				phandle = <0xf4>;
			};

			pinmux_P9_22_gpio_pin {
				pinctrl-single,pins = <0x150 0x2f>;
				linux,phandle = <0xf5>;
				phandle = <0xf5>;
			};

			pinmux_P9_22_gpio_pu_pin {
				pinctrl-single,pins = <0x150 0x37>;
				linux,phandle = <0xf6>;
				phandle = <0xf6>;
			};

			pinmux_P9_22_gpio_pd_pin {
				pinctrl-single,pins = <0x150 0x27>;
				linux,phandle = <0xf7>;
				phandle = <0xf7>;
			};

			pinmux_P9_22_gpio_input_pin {
				pinctrl-single,pins = <0x150 0x2f>;
				linux,phandle = <0xf8>;
				phandle = <0xf8>;
			};

			pinmux_P9_22_spi_sclk_pin {
				pinctrl-single,pins = <0x150 0x30>;
				linux,phandle = <0xf9>;
				phandle = <0xf9>;
			};

			pinmux_P9_22_uart_pin {
				pinctrl-single,pins = <0x150 0x31>;
				linux,phandle = <0xfa>;
				phandle = <0xfa>;
			};

			pinmux_P9_22_i2c_pin {
				pinctrl-single,pins = <0x150 0x32>;
				linux,phandle = <0xfb>;
				phandle = <0xfb>;
			};

			pinmux_P9_22_pwm_pin {
				pinctrl-single,pins = <0x150 0x23>;
				linux,phandle = <0xfc>;
				phandle = <0xfc>;
			};

			pinmux_P9_22_pru_uart_pin {
				pinctrl-single,pins = <0x150 0x34>;
				linux,phandle = <0xfd>;
				phandle = <0xfd>;
			};

			pinmux_P9_23_default_pin {
				pinctrl-single,pins = <0x44 0x27>;
				linux,phandle = <0xfe>;
				phandle = <0xfe>;
			};

			pinmux_P9_23_gpio_pin {
				pinctrl-single,pins = <0x44 0x2f>;
				linux,phandle = <0xff>;
				phandle = <0xff>;
			};

			pinmux_P9_23_gpio_pu_pin {
				pinctrl-single,pins = <0x44 0x37>;
				linux,phandle = <0x100>;
				phandle = <0x100>;
			};

			pinmux_P9_23_gpio_pd_pin {
				pinctrl-single,pins = <0x44 0x27>;
				linux,phandle = <0x101>;
				phandle = <0x101>;
			};

			pinmux_P9_23_gpio_input_pin {
				pinctrl-single,pins = <0x44 0x2f>;
				linux,phandle = <0x102>;
				phandle = <0x102>;
			};

			pinmux_P9_23_pwm_pin {
				pinctrl-single,pins = <0x44 0x26>;
				linux,phandle = <0x103>;
				phandle = <0x103>;
			};

			pinmux_P9_24_default_pin {
				pinctrl-single,pins = <0x184 0x30>;
				linux,phandle = <0x104>;
				phandle = <0x104>;
			};

			pinmux_P9_24_gpio_pin {
				pinctrl-single,pins = <0x184 0x2f>;
				linux,phandle = <0x105>;
				phandle = <0x105>;
			};

			pinmux_P9_24_gpio_pu_pin {
				pinctrl-single,pins = <0x184 0x37>;
				linux,phandle = <0x106>;
				phandle = <0x106>;
			};

			pinmux_P9_24_gpio_pd_pin {
				pinctrl-single,pins = <0x184 0x27>;
				linux,phandle = <0x107>;
				phandle = <0x107>;
			};

			pinmux_P9_24_gpio_input_pin {
				pinctrl-single,pins = <0x184 0x2f>;
				linux,phandle = <0x108>;
				phandle = <0x108>;
			};

			pinmux_P9_24_uart_pin {
				pinctrl-single,pins = <0x184 0x30>;
				linux,phandle = <0x109>;
				phandle = <0x109>;
			};

			pinmux_P9_24_can_pin {
				pinctrl-single,pins = <0x184 0x32>;
				linux,phandle = <0x10a>;
				phandle = <0x10a>;
			};

			pinmux_P9_24_i2c_pin {
				pinctrl-single,pins = <0x184 0x33>;
				linux,phandle = <0x10b>;
				phandle = <0x10b>;
			};

			pinmux_P9_24_pru_uart_pin {
				pinctrl-single,pins = <0x184 0x35>;
				linux,phandle = <0x10c>;
				phandle = <0x10c>;
			};

			pinmux_P9_24_pruin_pin {
				pinctrl-single,pins = <0x184 0x2e>;
				linux,phandle = <0x10d>;
				phandle = <0x10d>;
			};

			pinmux_P9_25_default_pin {
				pinctrl-single,pins = <0x1ac 0x2f>;
				linux,phandle = <0x10e>;
				phandle = <0x10e>;
			};

			pinmux_P9_25_gpio_pin {
				pinctrl-single,pins = <0x1ac 0x2f>;
				linux,phandle = <0x10f>;
				phandle = <0x10f>;
			};

			pinmux_P9_25_gpio_pu_pin {
				pinctrl-single,pins = <0x1ac 0x37>;
				linux,phandle = <0x110>;
				phandle = <0x110>;
			};

			pinmux_P9_25_gpio_pd_pin {
				pinctrl-single,pins = <0x1ac 0x27>;
				linux,phandle = <0x111>;
				phandle = <0x111>;
			};

			pinmux_P9_25_gpio_input_pin {
				pinctrl-single,pins = <0x1ac 0x2f>;
				linux,phandle = <0x112>;
				phandle = <0x112>;
			};

			pinmux_P9_25_qep_pin {
				pinctrl-single,pins = <0x1ac 0x31>;
				linux,phandle = <0x113>;
				phandle = <0x113>;
			};

			pinmux_P9_25_pruout_pin {
				pinctrl-single,pins = <0x1ac 0x25>;
				linux,phandle = <0x114>;
				phandle = <0x114>;
			};

			pinmux_P9_25_pruin_pin {
				pinctrl-single,pins = <0x1ac 0x2e>;
				linux,phandle = <0x115>;
				phandle = <0x115>;
			};

			pinmux_P9_26_default_pin {
				pinctrl-single,pins = <0x180 0x30>;
				linux,phandle = <0x116>;
				phandle = <0x116>;
			};

			pinmux_P9_26_gpio_pin {
				pinctrl-single,pins = <0x180 0x2f>;
				linux,phandle = <0x117>;
				phandle = <0x117>;
			};

			pinmux_P9_26_gpio_pu_pin {
				pinctrl-single,pins = <0x180 0x37>;
				linux,phandle = <0x118>;
				phandle = <0x118>;
			};

			pinmux_P9_26_gpio_pd_pin {
				pinctrl-single,pins = <0x180 0x27>;
				linux,phandle = <0x119>;
				phandle = <0x119>;
			};

			pinmux_P9_26_gpio_input_pin {
				pinctrl-single,pins = <0x180 0x2f>;
				linux,phandle = <0x11a>;
				phandle = <0x11a>;
			};

			pinmux_P9_26_uart_pin {
				pinctrl-single,pins = <0x180 0x30>;
				linux,phandle = <0x11b>;
				phandle = <0x11b>;
			};

			pinmux_P9_26_can_pin {
				pinctrl-single,pins = <0x180 0x12>;
				linux,phandle = <0x11c>;
				phandle = <0x11c>;
			};

			pinmux_P9_26_i2c_pin {
				pinctrl-single,pins = <0x180 0x33>;
				linux,phandle = <0x11d>;
				phandle = <0x11d>;
			};

			pinmux_P9_26_pru_uart_pin {
				pinctrl-single,pins = <0x180 0x35>;
				linux,phandle = <0x11e>;
				phandle = <0x11e>;
			};

			pinmux_P9_26_pruin_pin {
				pinctrl-single,pins = <0x180 0x2e>;
				linux,phandle = <0x11f>;
				phandle = <0x11f>;
			};

			pinmux_P9_27_default_pin {
				pinctrl-single,pins = <0x1a4 0x27>;
				linux,phandle = <0x120>;
				phandle = <0x120>;
			};

			pinmux_P9_27_gpio_pin {
				pinctrl-single,pins = <0x1a4 0x2f>;
				linux,phandle = <0x121>;
				phandle = <0x121>;
			};

			pinmux_P9_27_gpio_pu_pin {
				pinctrl-single,pins = <0x1a4 0x37>;
				linux,phandle = <0x122>;
				phandle = <0x122>;
			};

			pinmux_P9_27_gpio_pd_pin {
				pinctrl-single,pins = <0x1a4 0x27>;
				linux,phandle = <0x123>;
				phandle = <0x123>;
			};

			pinmux_P9_27_gpio_input_pin {
				pinctrl-single,pins = <0x1a4 0x2f>;
				linux,phandle = <0x124>;
				phandle = <0x124>;
			};

			pinmux_P9_27_qep_pin {
				pinctrl-single,pins = <0x1a4 0x31>;
				linux,phandle = <0x125>;
				phandle = <0x125>;
			};

			pinmux_P9_27_pruout_pin {
				pinctrl-single,pins = <0x1a4 0x25>;
				linux,phandle = <0x126>;
				phandle = <0x126>;
			};

			pinmux_P9_27_pruin_pin {
				pinctrl-single,pins = <0x1a4 0x2e>;
				linux,phandle = <0x127>;
				phandle = <0x127>;
			};

			pinmux_P9_28_default_pin {
				pinctrl-single,pins = <0x19c 0x33>;
				linux,phandle = <0x171>;
				phandle = <0x171>;
			};

			pinmux_P9_28_gpio_pin {
				pinctrl-single,pins = <0x19c 0x2f>;
				linux,phandle = <0x172>;
				phandle = <0x172>;
			};

			pinmux_P9_28_gpio_pu_pin {
				pinctrl-single,pins = <0x19c 0x37>;
				linux,phandle = <0x173>;
				phandle = <0x173>;
			};

			pinmux_P9_28_gpio_pd_pin {
				pinctrl-single,pins = <0x19c 0x27>;
				linux,phandle = <0x174>;
				phandle = <0x174>;
			};

			pinmux_P9_28_gpio_input_pin {
				pinctrl-single,pins = <0x19c 0x2f>;
				linux,phandle = <0x175>;
				phandle = <0x175>;
			};

			pinmux_P9_28_pwm_pin {
				pinctrl-single,pins = <0x19c 0x21>;
				linux,phandle = <0x176>;
				phandle = <0x176>;
			};

			pinmux_P9_28_pwm2_pin {
				pinctrl-single,pins = <0x19c 0x24>;
				linux,phandle = <0x177>;
				phandle = <0x177>;
			};

			pinmux_P9_28_spi_cs_pin {
				pinctrl-single,pins = <0x19c 0x33>;
				linux,phandle = <0x178>;
				phandle = <0x178>;
			};

			pinmux_P9_28_pruout_pin {
				pinctrl-single,pins = <0x19c 0x25>;
				linux,phandle = <0x179>;
				phandle = <0x179>;
			};

			pinmux_P9_28_pruin_pin {
				pinctrl-single,pins = <0x19c 0x2e>;
				linux,phandle = <0x17a>;
				phandle = <0x17a>;
			};

			pinmux_P9_29_default_pin {
				pinctrl-single,pins = <0x194 0x33>;
				linux,phandle = <0x128>;
				phandle = <0x128>;
			};

			pinmux_P9_29_gpio_pin {
				pinctrl-single,pins = <0x194 0x2f>;
				linux,phandle = <0x129>;
				phandle = <0x129>;
			};

			pinmux_P9_29_gpio_pu_pin {
				pinctrl-single,pins = <0x194 0x37>;
				linux,phandle = <0x12a>;
				phandle = <0x12a>;
			};

			pinmux_P9_29_gpio_pd_pin {
				pinctrl-single,pins = <0x194 0x27>;
				linux,phandle = <0x12b>;
				phandle = <0x12b>;
			};

			pinmux_P9_29_gpio_input_pin {
				pinctrl-single,pins = <0x194 0x2f>;
				linux,phandle = <0x12c>;
				phandle = <0x12c>;
			};

			pinmux_P9_29_pwm_pin {
				pinctrl-single,pins = <0x194 0x21>;
				linux,phandle = <0x12e>;
				phandle = <0x12e>;
			};

			pinmux_P9_29_spi_pin {
				pinctrl-single,pins = <0x194 0x33>;
				linux,phandle = <0x12d>;
				phandle = <0x12d>;
			};

			pinmux_P9_29_pruout_pin {
				pinctrl-single,pins = <0x194 0x25>;
				linux,phandle = <0x12f>;
				phandle = <0x12f>;
			};

			pinmux_P9_29_pruin_pin {
				pinctrl-single,pins = <0x194 0x2e>;
				linux,phandle = <0x130>;
				phandle = <0x130>;
			};

			pinmux_P9_30_default_pin {
				pinctrl-single,pins = <0x198 0x33>;
				linux,phandle = <0x131>;
				phandle = <0x131>;
			};

			pinmux_P9_30_gpio_pin {
				pinctrl-single,pins = <0x198 0x2f>;
				linux,phandle = <0x132>;
				phandle = <0x132>;
			};

			pinmux_P9_30_gpio_pu_pin {
				pinctrl-single,pins = <0x198 0x37>;
				linux,phandle = <0x133>;
				phandle = <0x133>;
			};

			pinmux_P9_30_gpio_pd_pin {
				pinctrl-single,pins = <0x198 0x27>;
				linux,phandle = <0x134>;
				phandle = <0x134>;
			};

			pinmux_P9_30_gpio_input_pin {
				pinctrl-single,pins = <0x198 0x2f>;
				linux,phandle = <0x135>;
				phandle = <0x135>;
			};

			pinmux_P9_30_pwm_pin {
				pinctrl-single,pins = <0x198 0x21>;
				linux,phandle = <0x137>;
				phandle = <0x137>;
			};

			pinmux_P9_30_spi_pin {
				pinctrl-single,pins = <0x198 0x33>;
				linux,phandle = <0x136>;
				phandle = <0x136>;
			};

			pinmux_P9_30_pruout_pin {
				pinctrl-single,pins = <0x198 0x25>;
				linux,phandle = <0x138>;
				phandle = <0x138>;
			};

			pinmux_P9_30_pruin_pin {
				pinctrl-single,pins = <0x198 0x2e>;
				linux,phandle = <0x139>;
				phandle = <0x139>;
			};

			pinmux_P9_31_default_pin {
				pinctrl-single,pins = <0x190 0x33>;
				linux,phandle = <0x13a>;
				phandle = <0x13a>;
			};

			pinmux_P9_31_gpio_pin {
				pinctrl-single,pins = <0x190 0x2f>;
				linux,phandle = <0x13b>;
				phandle = <0x13b>;
			};

			pinmux_P9_31_gpio_pu_pin {
				pinctrl-single,pins = <0x190 0x37>;
				linux,phandle = <0x13c>;
				phandle = <0x13c>;
			};

			pinmux_P9_31_gpio_pd_pin {
				pinctrl-single,pins = <0x190 0x27>;
				linux,phandle = <0x13d>;
				phandle = <0x13d>;
			};

			pinmux_P9_31_gpio_input_pin {
				pinctrl-single,pins = <0x190 0x2f>;
				linux,phandle = <0x13e>;
				phandle = <0x13e>;
			};

			pinmux_P9_31_pwm_pin {
				pinctrl-single,pins = <0x190 0x21>;
				linux,phandle = <0x140>;
				phandle = <0x140>;
			};

			pinmux_P9_31_spi_sclk_pin {
				pinctrl-single,pins = <0x190 0x33>;
				linux,phandle = <0x13f>;
				phandle = <0x13f>;
			};

			pinmux_P9_31_pruout_pin {
				pinctrl-single,pins = <0x190 0x25>;
				linux,phandle = <0x141>;
				phandle = <0x141>;
			};

			pinmux_P9_31_pruin_pin {
				pinctrl-single,pins = <0x190 0x2e>;
				linux,phandle = <0x142>;
				phandle = <0x142>;
			};

			pinmux_P9_41_default_pin {
				pinctrl-single,pins = <0x1b4 0xb>;
				linux,phandle = <0x143>;
				phandle = <0x143>;
			};

			pinmux_P9_41_gpio_pin {
				pinctrl-single,pins = <0x1b4 0x2f>;
				linux,phandle = <0x144>;
				phandle = <0x144>;
			};

			pinmux_P9_41_gpio_pu_pin {
				pinctrl-single,pins = <0x1b4 0x37>;
				linux,phandle = <0x145>;
				phandle = <0x145>;
			};

			pinmux_P9_41_gpio_pd_pin {
				pinctrl-single,pins = <0x1b4 0x27>;
				linux,phandle = <0x146>;
				phandle = <0x146>;
			};

			pinmux_P9_41_gpio_input_pin {
				pinctrl-single,pins = <0x1b4 0x2f>;
				linux,phandle = <0x147>;
				phandle = <0x147>;
			};

			pinmux_P9_41_clkout2_pin {
				pinctrl-single,pins = <0x1b4 0xb>;
				linux,phandle = <0x148>;
				phandle = <0x148>;
			};

			pinmux_P9_41_timer_pin {
				pinctrl-single,pins = <0x1b4 0x34>;
				linux,phandle = <0x149>;
				phandle = <0x149>;
			};

			pinmux_P9_41_pruin_pin {
				pinctrl-single,pins = <0x1b4 0x2d>;
				linux,phandle = <0x14a>;
				phandle = <0x14a>;
			};

			pinmux_P9_91_default_pin {
				pinctrl-single,pins = <0x1a8 0x27>;
				linux,phandle = <0x14b>;
				phandle = <0x14b>;
			};

			pinmux_P9_91_gpio_pin {
				pinctrl-single,pins = <0x1a8 0x2f>;
				linux,phandle = <0x14c>;
				phandle = <0x14c>;
			};

			pinmux_P9_91_gpio_pu_pin {
				pinctrl-single,pins = <0x1a8 0x37>;
				linux,phandle = <0x14d>;
				phandle = <0x14d>;
			};

			pinmux_P9_91_gpio_pd_pin {
				pinctrl-single,pins = <0x1a8 0x27>;
				linux,phandle = <0x14e>;
				phandle = <0x14e>;
			};

			pinmux_P9_91_gpio_input_pin {
				pinctrl-single,pins = <0x1a8 0x2f>;
				linux,phandle = <0x14f>;
				phandle = <0x14f>;
			};

			pinmux_P9_91_qep_pin {
				pinctrl-single,pins = <0x1a8 0x31>;
				linux,phandle = <0x150>;
				phandle = <0x150>;
			};

			pinmux_P9_91_pruout_pin {
				pinctrl-single,pins = <0x1a8 0x25>;
				linux,phandle = <0x151>;
				phandle = <0x151>;
			};

			pinmux_P9_91_pruin_pin {
				pinctrl-single,pins = <0x1a8 0x2e>;
				linux,phandle = <0x152>;
				phandle = <0x152>;
			};

			pinmux_P9_42_default_pin {
				pinctrl-single,pins = <0x164 0x32>;
				linux,phandle = <0x153>;
				phandle = <0x153>;
			};

			pinmux_P9_42_gpio_pin {
				pinctrl-single,pins = <0x164 0x2f>;
				linux,phandle = <0x154>;
				phandle = <0x154>;
			};

			pinmux_P9_42_gpio_pu_pin {
				pinctrl-single,pins = <0x164 0x37>;
				linux,phandle = <0x155>;
				phandle = <0x155>;
			};

			pinmux_P9_42_gpio_pd_pin {
				pinctrl-single,pins = <0x164 0x27>;
				linux,phandle = <0x156>;
				phandle = <0x156>;
			};

			pinmux_P9_42_gpio_input_pin {
				pinctrl-single,pins = <0x164 0x2f>;
				linux,phandle = <0x157>;
				phandle = <0x157>;
			};

			pinmux_P9_42_pwm_pin {
				pinctrl-single,pins = <0x164 0x20>;
				linux,phandle = <0x15b>;
				phandle = <0x15b>;
			};

			pinmux_P9_42_uart_pin {
				pinctrl-single,pins = <0x164 0x31>;
				linux,phandle = <0x15a>;
				phandle = <0x15a>;
			};

			pinmux_P9_42_spi_cs_pin {
				pinctrl-single,pins = <0x164 0x32>;
				linux,phandle = <0x158>;
				phandle = <0x158>;
			};

			pinmux_P9_42_pru_ecap_pin {
				pinctrl-single,pins = <0x164 0x23>;
				linux,phandle = <0x15c>;
				phandle = <0x15c>;
			};

			pinmux_P9_42_spi_sclk_pin {
				pinctrl-single,pins = <0x164 0x34>;
				linux,phandle = <0x159>;
				phandle = <0x159>;
			};

			pinmux_P9_93_default_pin {
				pinctrl-single,pins = <0x64 0x27>;
				linux,phandle = <0x15d>;
				phandle = <0x15d>;
			};

			pinmux_P9_93_gpio_pin {
				pinctrl-single,pins = <0x64 0x2f>;
				linux,phandle = <0x15e>;
				phandle = <0x15e>;
			};

			pinmux_P9_93_gpio_pu_pin {
				pinctrl-single,pins = <0x64 0x37>;
				linux,phandle = <0x15f>;
				phandle = <0x15f>;
			};

			pinmux_P9_93_gpio_pd_pin {
				pinctrl-single,pins = <0x64 0x27>;
				linux,phandle = <0x160>;
				phandle = <0x160>;
			};

			pinmux_P9_93_gpio_input_pin {
				pinctrl-single,pins = <0x64 0x2f>;
				linux,phandle = <0x161>;
				phandle = <0x161>;
			};

			pinmux_P9_95_default_pin {
				pinctrl-single,pins = <0x16c 0x2f>;
				linux,phandle = <0x162>;
				phandle = <0x162>;
			};

			pinmux_P9_95_gpio_pin {
				pinctrl-single,pins = <0x16c 0x2f>;
				linux,phandle = <0x163>;
				phandle = <0x163>;
			};

			pinmux_P9_95_gpio_pu_pin {
				pinctrl-single,pins = <0x16c 0x37>;
				linux,phandle = <0x164>;
				phandle = <0x164>;
			};

			pinmux_P9_95_gpio_pd_pin {
				pinctrl-single,pins = <0x16c 0x27>;
				linux,phandle = <0x165>;
				phandle = <0x165>;
			};

			pinmux_P9_95_gpio_input_pin {
				pinctrl-single,pins = <0x16c 0x2f>;
				linux,phandle = <0x166>;
				phandle = <0x166>;
			};

			pinmux_P9_96_default_pin {
				pinctrl-single,pins = <0x168 0x27>;
				linux,phandle = <0x167>;
				phandle = <0x167>;
			};

			pinmux_P9_96_gpio_pin {
				pinctrl-single,pins = <0x168 0x2f>;
				linux,phandle = <0x168>;
				phandle = <0x168>;
			};

			pinmux_P9_96_gpio_pu_pin {
				pinctrl-single,pins = <0x168 0x37>;
				linux,phandle = <0x169>;
				phandle = <0x169>;
			};

			pinmux_P9_96_gpio_pd_pin {
				pinctrl-single,pins = <0x168 0x27>;
				linux,phandle = <0x16a>;
				phandle = <0x16a>;
			};

			pinmux_P9_96_gpio_input_pin {
				pinctrl-single,pins = <0x168 0x2f>;
				linux,phandle = <0x16b>;
				phandle = <0x16b>;
			};

			pinmux_P9_97_default_pin {
				pinctrl-single,pins = <0x6c 0x27>;
				linux,phandle = <0x16c>;
				phandle = <0x16c>;
			};

			pinmux_P9_97_gpio_pin {
				pinctrl-single,pins = <0x6c 0x2f>;
				linux,phandle = <0x16d>;
				phandle = <0x16d>;
			};

			pinmux_P9_97_gpio_pu_pin {
				pinctrl-single,pins = <0x6c 0x37>;
				linux,phandle = <0x16e>;
				phandle = <0x16e>;
			};

			pinmux_P9_97_gpio_pd_pin {
				pinctrl-single,pins = <0x6c 0x27>;
				linux,phandle = <0x16f>;
				phandle = <0x16f>;
			};

			pinmux_P9_97_gpio_input_pin {
				pinctrl-single,pins = <0x6c 0x2f>;
				linux,phandle = <0x170>;
				phandle = <0x170>;
			};
		};
	};

	fragment@1 {
		target = <0xffffffff>;

		__overlay__ {

			P8_07_pinmux {
				compatible = "bone-pinmux-helper";
				status = "okay";
				pinctrl-names = "default", "gpio", "gpio_pu", "gpio_pd", "gpio_input", "timer";
				pinctrl-0 = <0x1>;
				pinctrl-1 = <0x2>;
				pinctrl-2 = <0x3>;
				pinctrl-3 = <0x4>;
				pinctrl-4 = <0x5>;
				pinctrl-5 = <0x6>;
			};

			P8_08_pinmux {
				compatible = "bone-pinmux-helper";
				status = "okay";
				pinctrl-names = "default", "gpio", "gpio_pu", "gpio_pd", "gpio_input", "timer";
				pinctrl-0 = <0x7>;
				pinctrl-1 = <0x8>;
				pinctrl-2 = <0x9>;
				pinctrl-3 = <0xa>;
				pinctrl-4 = <0xb>;
				pinctrl-5 = <0xc>;
			};

			P8_09_pinmux {
				compatible = "bone-pinmux-helper";
				status = "okay";
				pinctrl-names = "default", "gpio", "gpio_pu", "gpio_pd", "gpio_input", "timer";
				pinctrl-0 = <0xd>;
				pinctrl-1 = <0xe>;
				pinctrl-2 = <0xf>;
				pinctrl-3 = <0x10>;
				pinctrl-4 = <0x11>;
				pinctrl-5 = <0x12>;
			};

			P8_10_pinmux {
				compatible = "bone-pinmux-helper";
				status = "okay";
				pinctrl-names = "default", "gpio", "gpio_pu", "gpio_pd", "gpio_input", "timer";
				pinctrl-0 = <0x13>;
				pinctrl-1 = <0x14>;
				pinctrl-2 = <0x15>;
				pinctrl-3 = <0x16>;
				pinctrl-4 = <0x17>;
				pinctrl-5 = <0x18>;
			};

			P8_13_pinmux {
				compatible = "bone-pinmux-helper";
				status = "okay";
				pinctrl-names = "default", "gpio", "gpio_pu", "gpio_pd", "gpio_input", "pwm";
				pinctrl-0 = <0x19>;
				pinctrl-1 = <0x1a>;
				pinctrl-2 = <0x1b>;
				pinctrl-3 = <0x1c>;
				pinctrl-4 = <0x1d>;
				pinctrl-5 = <0x1e>;
			};

			P8_19_pinmux {
				compatible = "bone-pinmux-helper";
				status = "okay";
				pinctrl-names = "default", "gpio", "gpio_pu", "gpio_pd", "gpio_input", "pwm";
				pinctrl-0 = <0x1f>;
				pinctrl-1 = <0x20>;
				pinctrl-2 = <0x21>;
				pinctrl-3 = <0x22>;
				pinctrl-4 = <0x23>;
				pinctrl-5 = <0x24>;
			};

			P8_27_pinmux {
				compatible = "bone-pinmux-helper";
				status = "okay";
				pinctrl-names = "default", "gpio", "gpio_pu", "gpio_pd", "gpio_input", "pruout", "pruin";
				pinctrl-0 = <0x25>;
				pinctrl-1 = <0x26>;
				pinctrl-2 = <0x27>;
				pinctrl-3 = <0x28>;
				pinctrl-4 = <0x29>;
				pinctrl-5 = <0x2a>;
				pinctrl-6 = <0x2b>;
			};

			P8_28_pinmux {
				compatible = "bone-pinmux-helper";
				status = "okay";
				pinctrl-names = "default", "gpio", "gpio_pu", "gpio_pd", "gpio_input", "pruout", "pruin";
				pinctrl-0 = <0x2c>;
				pinctrl-1 = <0x2d>;
				pinctrl-2 = <0x2e>;
				pinctrl-3 = <0x2f>;
				pinctrl-4 = <0x30>;
				pinctrl-5 = <0x31>;
				pinctrl-6 = <0x32>;
			};

			P8_29_pinmux {
				compatible = "bone-pinmux-helper";
				status = "okay";
				pinctrl-names = "default", "gpio", "gpio_pu", "gpio_pd", "gpio_input", "pruout", "pruin";
				pinctrl-0 = <0x33>;
				pinctrl-1 = <0x34>;
				pinctrl-2 = <0x35>;
				pinctrl-3 = <0x36>;
				pinctrl-4 = <0x37>;
				pinctrl-5 = <0x38>;
				pinctrl-6 = <0x39>;
			};

			P8_30_pinmux {
				compatible = "bone-pinmux-helper";
				status = "okay";
				pinctrl-names = "default", "gpio", "gpio_pu", "gpio_pd", "gpio_input", "pruout", "pruin";
				pinctrl-0 = <0x3a>;
				pinctrl-1 = <0x3b>;
				pinctrl-2 = <0x3c>;
				pinctrl-3 = <0x3d>;
				pinctrl-4 = <0x3e>;
				pinctrl-5 = <0x3f>;
				pinctrl-6 = <0x40>;
			};

			P8_31_pinmux {
				compatible = "bone-pinmux-helper";
				status = "okay";
				pinctrl-names = "default", "gpio", "gpio_pu", "gpio_pd", "gpio_input", "uart", "qep";
				pinctrl-0 = <0x41>;
				pinctrl-1 = <0x42>;
				pinctrl-2 = <0x43>;
				pinctrl-3 = <0x44>;
				pinctrl-4 = <0x45>;
				pinctrl-5 = <0x46>;
				pinctrl-6 = <0x47>;
			};

			P8_32_pinmux {
				compatible = "bone-pinmux-helper";
				status = "okay";
				pinctrl-names = "default", "gpio", "gpio_pu", "gpio_pd", "gpio_input", "qep";
				pinctrl-0 = <0x48>;
				pinctrl-1 = <0x49>;
				pinctrl-2 = <0x4a>;
				pinctrl-3 = <0x4b>;
				pinctrl-4 = <0x4c>;
				pinctrl-5 = <0x4d>;
			};

			P8_33_pinmux {
				compatible = "bone-pinmux-helper";
				status = "okay";
				pinctrl-names = "default", "gpio", "gpio_pu", "gpio_pd", "gpio_input", "qep";
				pinctrl-0 = <0x4e>;
				pinctrl-1 = <0x4f>;
				pinctrl-2 = <0x50>;
				pinctrl-3 = <0x51>;
				pinctrl-4 = <0x52>;
				pinctrl-5 = <0x53>;
			};

			P8_34_pinmux {
				compatible = "bone-pinmux-helper";
				status = "okay";
				pinctrl-names = "default", "gpio", "gpio_pu", "gpio_pd", "gpio_input", "pwm";
				pinctrl-0 = <0x54>;
				pinctrl-1 = <0x55>;
				pinctrl-2 = <0x56>;
				pinctrl-3 = <0x57>;
				pinctrl-4 = <0x58>;
				pinctrl-5 = <0x59>;
			};

			P8_35_pinmux {
				compatible = "bone-pinmux-helper";
				status = "okay";
				pinctrl-names = "default", "gpio", "gpio_pu", "gpio_pd", "gpio_input", "qep";
				pinctrl-0 = <0x5a>;
				pinctrl-1 = <0x5b>;
				pinctrl-2 = <0x5c>;
				pinctrl-3 = <0x5d>;
				pinctrl-4 = <0x5e>;
				pinctrl-5 = <0x5f>;
			};

			P8_36_pinmux {
				compatible = "bone-pinmux-helper";
				status = "okay";
				pinctrl-names = "default", "gpio", "gpio_pu", "gpio_pd", "gpio_input", "pwm";
				pinctrl-0 = <0x60>;
				pinctrl-1 = <0x61>;
				pinctrl-2 = <0x62>;
				pinctrl-3 = <0x63>;
				pinctrl-4 = <0x64>;
				pinctrl-5 = <0x65>;
			};

			P8_39_pinmux {
				compatible = "bone-pinmux-helper";
				status = "okay";
				pinctrl-names = "default", "gpio", "gpio_pu", "gpio_pd", "gpio_input", "qep", "pruout", "pruin";
				pinctrl-0 = <0x66>;
				pinctrl-1 = <0x67>;
				pinctrl-2 = <0x68>;
				pinctrl-3 = <0x69>;
				pinctrl-4 = <0x6a>;
				pinctrl-5 = <0x6b>;
				pinctrl-6 = <0x6c>;
				pinctrl-7 = <0x6d>;
			};

			P8_40_pinmux {
				compatible = "bone-pinmux-helper";
				status = "okay";
				pinctrl-names = "default", "gpio", "gpio_pu", "gpio_pd", "gpio_input", "qep", "pruout", "pruin";
				pinctrl-0 = <0x6e>;
				pinctrl-1 = <0x6f>;
				pinctrl-2 = <0x70>;
				pinctrl-3 = <0x71>;
				pinctrl-4 = <0x72>;
				pinctrl-5 = <0x73>;
				pinctrl-6 = <0x74>;
				pinctrl-7 = <0x75>;
			};

			P8_41_pinmux {
				compatible = "bone-pinmux-helper";
				status = "okay";
				pinctrl-names = "default", "gpio", "gpio_pu", "gpio_pd", "gpio_input", "qep", "pruout", "pruin";
				pinctrl-0 = <0x76>;
				pinctrl-1 = <0x77>;
				pinctrl-2 = <0x78>;
				pinctrl-3 = <0x79>;
				pinctrl-4 = <0x7a>;
				pinctrl-5 = <0x7b>;
				pinctrl-6 = <0x7c>;
				pinctrl-7 = <0x7d>;
			};

			P8_42_pinmux {
				compatible = "bone-pinmux-helper";
				status = "okay";
				pinctrl-names = "default", "gpio", "gpio_pu", "gpio_pd", "gpio_input", "qep", "pruout", "pruin";
				pinctrl-0 = <0x7e>;
				pinctrl-1 = <0x7f>;
				pinctrl-2 = <0x80>;
				pinctrl-3 = <0x81>;
				pinctrl-4 = <0x82>;
				pinctrl-5 = <0x83>;
				pinctrl-6 = <0x84>;
				pinctrl-7 = <0x85>;
			};

			P8_43_pinmux {
				compatible = "bone-pinmux-helper";
				status = "okay";
				pinctrl-names = "default", "gpio", "gpio_pu", "gpio_pd", "gpio_input", "pwm", "pruout", "pruin";
				pinctrl-0 = <0x86>;
				pinctrl-1 = <0x87>;
				pinctrl-2 = <0x88>;
				pinctrl-3 = <0x89>;
				pinctrl-4 = <0x8a>;
				pinctrl-5 = <0x8b>;
				pinctrl-6 = <0x8c>;
				pinctrl-7 = <0x8d>;
			};

			P8_44_pinmux {
				compatible = "bone-pinmux-helper";
				status = "okay";
				pinctrl-names = "default", "gpio", "gpio_pu", "gpio_pd", "gpio_input", "pwm", "pruout", "pruin";
				pinctrl-0 = <0x8e>;
				pinctrl-1 = <0x8f>;
				pinctrl-2 = <0x90>;
				pinctrl-3 = <0x91>;
				pinctrl-4 = <0x92>;
				pinctrl-5 = <0x93>;
				pinctrl-6 = <0x94>;
				pinctrl-7 = <0x95>;
			};

			P8_45_pinmux {
				compatible = "bone-pinmux-helper";
				status = "okay";
				pinctrl-names = "default", "gpio", "gpio_pu", "gpio_pd", "gpio_input", "pwm", "pruout", "pruin";
				pinctrl-0 = <0x96>;
				pinctrl-1 = <0x97>;
				pinctrl-2 = <0x98>;
				pinctrl-3 = <0x99>;
				pinctrl-4 = <0x9a>;
				pinctrl-5 = <0x9b>;
				pinctrl-6 = <0x9c>;
				pinctrl-7 = <0x9d>;
			};

			P8_46_pinmux {
				compatible = "bone-pinmux-helper";
				status = "okay";
				pinctrl-names = "default", "gpio", "gpio_pu", "gpio_pd", "gpio_input", "pwm", "pruout", "pruin";
				pinctrl-0 = <0x9e>;
				pinctrl-1 = <0x9f>;
				pinctrl-2 = <0xa0>;
				pinctrl-3 = <0xa1>;
				pinctrl-4 = <0xa2>;
				pinctrl-5 = <0xa3>;
				pinctrl-6 = <0xa4>;
				pinctrl-7 = <0xa5>;
			};

			P9_11_pinmux {
				compatible = "bone-pinmux-helper";
				status = "okay";
				pinctrl-names = "default", "gpio", "gpio_pu", "gpio_pd", "gpio_input", "uart";
				pinctrl-0 = <0xa6>;
				pinctrl-1 = <0xa7>;
				pinctrl-2 = <0xa8>;
				pinctrl-3 = <0xa9>;
				pinctrl-4 = <0xaa>;
				pinctrl-5 = <0xab>;
			};

			P9_13_pinmux {
				compatible = "bone-pinmux-helper";
				status = "okay";
				pinctrl-names = "default", "gpio", "gpio_pu", "gpio_pd", "gpio_input", "uart";
				pinctrl-0 = <0xac>;
				pinctrl-1 = <0xad>;
				pinctrl-2 = <0xae>;
				pinctrl-3 = <0xaf>;
				pinctrl-4 = <0xb0>;
				pinctrl-5 = <0xb1>;
			};

			P9_14_pinmux {
				compatible = "bone-pinmux-helper";
				status = "okay";
				pinctrl-names = "default", "gpio", "gpio_pu", "gpio_pd", "gpio_input", "pwm";
				pinctrl-0 = <0xb2>;
				pinctrl-1 = <0xb3>;
				pinctrl-2 = <0xb4>;
				pinctrl-3 = <0xb5>;
				pinctrl-4 = <0xb6>;
				pinctrl-5 = <0xb7>;
			};

			P9_15_pinmux {
				compatible = "bone-pinmux-helper";
				status = "okay";
				pinctrl-names = "default", "gpio", "gpio_pu", "gpio_pd", "gpio_input", "pwm";
				pinctrl-0 = <0xb8>;
				pinctrl-1 = <0xb9>;
				pinctrl-2 = <0xba>;
				pinctrl-3 = <0xbb>;
				pinctrl-4 = <0xbc>;
				pinctrl-5 = <0xbd>;
			};

			P9_16_pinmux {
				compatible = "bone-pinmux-helper";
				status = "okay";
				pinctrl-names = "default", "gpio", "gpio_pu", "gpio_pd", "gpio_input", "pwm";
				pinctrl-0 = <0xbe>;
				pinctrl-1 = <0xbf>;
				pinctrl-2 = <0xc0>;
				pinctrl-3 = <0xc1>;
				pinctrl-4 = <0xc2>;
				pinctrl-5 = <0xc3>;
			};

			P9_17_pinmux {
				compatible = "bone-pinmux-helper";
				status = "okay";
				pinctrl-names = "default", "gpio", "gpio_pu", "gpio_pd", "gpio_input", "spi_cs", "i2c", "pwm", "pru_uart";
				pinctrl-0 = <0xc4>;
				pinctrl-1 = <0xc5>;
				pinctrl-2 = <0xc6>;
				pinctrl-3 = <0xc7>;
				pinctrl-4 = <0xc8>;
				pinctrl-5 = <0xc9>;
				pinctrl-6 = <0xca>;
				pinctrl-7 = <0xcb>;
				pinctrl-8 = <0xcc>;
			};

			P9_18_pinmux {
				compatible = "bone-pinmux-helper";
				status = "okay";
				pinctrl-names = "default", "gpio", "gpio_pu", "gpio_pd", "gpio_input", "spi", "i2c", "pwm", "pru_uart";
				pinctrl-0 = <0xcd>;
				pinctrl-1 = <0xce>;
				pinctrl-2 = <0xcf>;
				pinctrl-3 = <0xd0>;
				pinctrl-4 = <0xd1>;
				pinctrl-5 = <0xd2>;
				pinctrl-6 = <0xd3>;
				pinctrl-7 = <0xd4>;
				pinctrl-8 = <0xd5>;
			};

			P9_19_pinmux {
				compatible = "bone-pinmux-helper";
				status = "okay";
				pinctrl-names = "default", "gpio", "gpio_pu", "gpio_pd", "gpio_input", "timer", "can", "i2c", "pwm", "pru_uart";
				pinctrl-0 = <0xd6>;
				pinctrl-1 = <0xd7>;
				pinctrl-2 = <0xd8>;
				pinctrl-3 = <0xd9>;
				pinctrl-4 = <0xda>;
				pinctrl-5 = <0xdb>;
				pinctrl-6 = <0xdc>;
				pinctrl-7 = <0xdd>;
				pinctrl-8 = <0xde>;
				pinctrl-9 = <0xdf>;
			};

			P9_20_pinmux {
				compatible = "bone-pinmux-helper";
				status = "okay";
				pinctrl-names = "default", "gpio", "gpio_pu", "gpio_pd", "gpio_input", "timer", "can", "i2c", "spi", "pru_uart";
				pinctrl-0 = <0xe0>;
				pinctrl-1 = <0xe1>;
				pinctrl-2 = <0xe2>;
				pinctrl-3 = <0xe3>;
				pinctrl-4 = <0xe4>;
				pinctrl-5 = <0xe5>;
				pinctrl-6 = <0xe6>;
				pinctrl-7 = <0xe7>;
				pinctrl-8 = <0xe8>;
				pinctrl-9 = <0xe9>;
			};

			P9_21_pinmux {
				compatible = "bone-pinmux-helper";
				status = "okay";
				pinctrl-names = "default", "gpio", "gpio_pu", "gpio_pd", "gpio_input", "spi", "uart", "i2c", "pwm", "pru_uart";
				pinctrl-0 = <0xea>;
				pinctrl-1 = <0xeb>;
				pinctrl-2 = <0xec>;
				pinctrl-3 = <0xed>;
				pinctrl-4 = <0xee>;
				pinctrl-5 = <0xef>;
				pinctrl-6 = <0xf0>;
				pinctrl-7 = <0xf1>;
				pinctrl-8 = <0xf2>;
				pinctrl-9 = <0xf3>;
			};

			P9_22_pinmux {
				compatible = "bone-pinmux-helper";
				status = "okay";
				pinctrl-names = "default", "gpio", "gpio_pu", "gpio_pd", "gpio_input", "spi_sclk", "uart", "i2c", "pwm", "pru_uart";
				pinctrl-0 = <0xf4>;
				pinctrl-1 = <0xf5>;
				pinctrl-2 = <0xf6>;
				pinctrl-3 = <0xf7>;
				pinctrl-4 = <0xf8>;
				pinctrl-5 = <0xf9>;
				pinctrl-6 = <0xfa>;
				pinctrl-7 = <0xfb>;
				pinctrl-8 = <0xfc>;
				pinctrl-9 = <0xfd>;
			};

			P9_23_pinmux {
				compatible = "bone-pinmux-helper";
				status = "okay";
				pinctrl-names = "default", "gpio", "gpio_pu", "gpio_pd", "gpio_input", "pwm";
				pinctrl-0 = <0xfe>;
				pinctrl-1 = <0xff>;
				pinctrl-2 = <0x100>;
				pinctrl-3 = <0x101>;
				pinctrl-4 = <0x102>;
				pinctrl-5 = <0x103>;
			};

			P9_24_pinmux {
				compatible = "bone-pinmux-helper";
				status = "okay";
				pinctrl-names = "default", "gpio", "gpio_pu", "gpio_pd", "gpio_input", "uart", "can", "i2c", "pru_uart", "pruin";
				pinctrl-0 = <0x104>;
				pinctrl-1 = <0x105>;
				pinctrl-2 = <0x106>;
				pinctrl-3 = <0x107>;
				pinctrl-4 = <0x108>;
				pinctrl-5 = <0x109>;
				pinctrl-6 = <0x10a>;
				pinctrl-7 = <0x10b>;
				pinctrl-8 = <0x10c>;
				pinctrl-9 = <0x10d>;
			};

			P9_25_pinmux {
				compatible = "bone-pinmux-helper";
				status = "okay";
				pinctrl-names = "default", "gpio", "gpio_pu", "gpio_pd", "gpio_input", "qep", "pruout", "pruin";
				pinctrl-0 = <0x10e>;
				pinctrl-1 = <0x10f>;
				pinctrl-2 = <0x110>;
				pinctrl-3 = <0x111>;
				pinctrl-4 = <0x112>;
				pinctrl-5 = <0x113>;
				pinctrl-6 = <0x114>;
				pinctrl-7 = <0x115>;
			};

			P9_26_pinmux {
				compatible = "bone-pinmux-helper";
				status = "okay";
				pinctrl-names = "default", "gpio", "gpio_pu", "gpio_pd", "gpio_input", "uart", "can", "i2c", "pru_uart", "pruin";
				pinctrl-0 = <0x116>;
				pinctrl-1 = <0x117>;
				pinctrl-2 = <0x118>;
				pinctrl-3 = <0x119>;
				pinctrl-4 = <0x11a>;
				pinctrl-5 = <0x11b>;
				pinctrl-6 = <0x11c>;
				pinctrl-7 = <0x11d>;
				pinctrl-8 = <0x11e>;
				pinctrl-9 = <0x11f>;
			};

			P9_27_pinmux {
				compatible = "bone-pinmux-helper";
				status = "okay";
				pinctrl-names = "default", "gpio", "gpio_pu", "gpio_pd", "gpio_input", "qep", "pruout", "pruin";
				pinctrl-0 = <0x120>;
				pinctrl-1 = <0x121>;
				pinctrl-2 = <0x122>;
				pinctrl-3 = <0x123>;
				pinctrl-4 = <0x124>;
				pinctrl-5 = <0x125>;
				pinctrl-6 = <0x126>;
				pinctrl-7 = <0x127>;
			};

			P9_29_pinmux {
				compatible = "bone-pinmux-helper";
				status = "okay";
				pinctrl-names = "default", "gpio", "gpio_pu", "gpio_pd", "gpio_input", "spi", "pwm", "pruout", "pruin";
				pinctrl-0 = <0x128>;
				pinctrl-1 = <0x129>;
				pinctrl-2 = <0x12a>;
				pinctrl-3 = <0x12b>;
				pinctrl-4 = <0x12c>;
				pinctrl-5 = <0x12d>;
				pinctrl-6 = <0x12e>;
				pinctrl-7 = <0x12f>;
				pinctrl-8 = <0x130>;
			};

			P9_30_pinmux {
				compatible = "bone-pinmux-helper";
				status = "okay";
				pinctrl-names = "default", "gpio", "gpio_pu", "gpio_pd", "gpio_input", "spi", "pwm", "pruout", "pruin";
				pinctrl-0 = <0x131>;
				pinctrl-1 = <0x132>;
				pinctrl-2 = <0x133>;
				pinctrl-3 = <0x134>;
				pinctrl-4 = <0x135>;
				pinctrl-5 = <0x136>;
				pinctrl-6 = <0x137>;
				pinctrl-7 = <0x138>;
				pinctrl-8 = <0x139>;
			};

			P9_31_pinmux {
				compatible = "bone-pinmux-helper";
				status = "okay";
				pinctrl-names = "default", "gpio", "gpio_pu", "gpio_pd", "gpio_input", "spi_sclk", "pwm", "pruout", "pruin";
				pinctrl-0 = <0x13a>;
				pinctrl-1 = <0x13b>;
				pinctrl-2 = <0x13c>;
				pinctrl-3 = <0x13d>;
				pinctrl-4 = <0x13e>;
				pinctrl-5 = <0x13f>;
				pinctrl-6 = <0x140>;
				pinctrl-7 = <0x141>;
				pinctrl-8 = <0x142>;
			};

			P9_41_pinmux {
				compatible = "bone-pinmux-helper";
				status = "okay";
				pinctrl-names = "default", "gpio", "gpio_pu", "gpio_pd", "gpio_input", "clkout2", "timer", "pruin";
				pinctrl-0 = <0x143>;
				pinctrl-1 = <0x144>;
				pinctrl-2 = <0x145>;
				pinctrl-3 = <0x146>;
				pinctrl-4 = <0x147>;
				pinctrl-5 = <0x148>;
				pinctrl-6 = <0x149>;
				pinctrl-7 = <0x14a>;
			};

			P9_91_pinmux {
				compatible = "bone-pinmux-helper";
				status = "okay";
				pinctrl-names = "default", "gpio", "gpio_pu", "gpio_pd", "gpio_input", "qep", "pruout", "pruin";
				pinctrl-0 = <0x14b>;
				pinctrl-1 = <0x14c>;
				pinctrl-2 = <0x14d>;
				pinctrl-3 = <0x14e>;
				pinctrl-4 = <0x14f>;
				pinctrl-5 = <0x150>;
				pinctrl-6 = <0x151>;
				pinctrl-7 = <0x152>;
			};

			P9_42_pinmux {
				compatible = "bone-pinmux-helper";
				status = "okay";
				pinctrl-names = "default", "gpio", "gpio_pu", "gpio_pd", "gpio_input", "spi_cs", "spi_sclk", "uart", "pwm", "pru_ecap";
				pinctrl-0 = <0x153>;
				pinctrl-1 = <0x154>;
				pinctrl-2 = <0x155>;
				pinctrl-3 = <0x156>;
				pinctrl-4 = <0x157>;
				pinctrl-5 = <0x158>;
				pinctrl-6 = <0x159>;
				pinctrl-7 = <0x15a>;
				pinctrl-8 = <0x15b>;
				pinctrl-9 = <0x15c>;
			};

			P9_93_pinmux {
				compatible = "bone-pinmux-helper";
				status = "okay";
				pinctrl-names = "default", "gpio", "gpio_pu", "gpio_pd", "gpio_input";
				pinctrl-0 = <0x15d>;
				pinctrl-1 = <0x15e>;
				pinctrl-2 = <0x15f>;
				pinctrl-3 = <0x160>;
				pinctrl-4 = <0x161>;
			};

			P9_95_pinmux {
				compatible = "bone-pinmux-helper";
				status = "okay";
				pinctrl-names = "default", "gpio", "gpio_pu", "gpio_pd", "gpio_input";
				pinctrl-0 = <0x162>;
				pinctrl-1 = <0x163>;
				pinctrl-2 = <0x164>;
				pinctrl-3 = <0x165>;
				pinctrl-4 = <0x166>;
			};

			P9_96_pinmux {
				compatible = "bone-pinmux-helper";
				status = "okay";
				pinctrl-names = "default", "gpio", "gpio_pu", "gpio_pd", "gpio_input";
				pinctrl-0 = <0x167>;
				pinctrl-1 = <0x168>;
				pinctrl-2 = <0x169>;
				pinctrl-3 = <0x16a>;
				pinctrl-4 = <0x16b>;
			};

			P9_97_pinmux {
				compatible = "bone-pinmux-helper";
				status = "okay";
				pinctrl-names = "default", "gpio", "gpio_pu", "gpio_pd", "gpio_input";
				pinctrl-0 = <0x16c>;
				pinctrl-1 = <0x16d>;
				pinctrl-2 = <0x16e>;
				pinctrl-3 = <0x16f>;
				pinctrl-4 = <0x170>;
			};
		};
	};

	fragment@2 {
		target = <0xffffffff>;

		__overlay__ {

			cape-universal {
				compatible = "gpio-of-helper";
				status = "okay";
				pinctrl-names = "default";
				pinctrl-0;

				P8_07 {
					gpio-name = "P8_07";
					gpio = <0xffffffff 0x2 0x0>;
					input;
					dir-changeable;
				};

				P8_08 {
					gpio-name = "P8_08";
					gpio = <0xffffffff 0x3 0x0>;
					input;
					dir-changeable;
				};

				P8_09 {
					gpio-name = "P8_09";
					gpio = <0xffffffff 0x5 0x0>;
					input;
					dir-changeable;
				};

				P8_10 {
					gpio-name = "P8_10";
					gpio = <0xffffffff 0x4 0x0>;
					input;
					dir-changeable;
				};

				P8_13 {
					gpio-name = "P8_13";
					gpio = <0xffffffff 0x17 0x0>;
					input;
					dir-changeable;
				};

				P8_19 {
					gpio-name = "P8_19";
					gpio = <0xffffffff 0x16 0x0>;
					input;
					dir-changeable;
				};

				P8_27 {
					gpio-name = "P8_27";
					gpio = <0xffffffff 0x16 0x0>;
					input;
					dir-changeable;
				};

				P8_28 {
					gpio-name = "P8_28";
					gpio = <0xffffffff 0x18 0x0>;
					input;
					dir-changeable;
				};

				P8_29 {
					gpio-name = "P8_29";
					gpio = <0xffffffff 0x17 0x0>;
					input;
					dir-changeable;
				};

				P8_30 {
					gpio-name = "P8_30";
					gpio = <0xffffffff 0x19 0x0>;
					input;
					dir-changeable;
				};

				P8_31 {
					gpio-name = "P8_31";
					gpio = <0xffffffff 0xa 0x0>;
					input;
					dir-changeable;
				};

				P8_32 {
					gpio-name = "P8_32";
					gpio = <0xffffffff 0xb 0x0>;
					input;
					dir-changeable;
				};

				P8_33 {
					gpio-name = "P8_33";
					gpio = <0xffffffff 0x9 0x0>;
					input;
					dir-changeable;
				};

				P8_34 {
					gpio-name = "P8_34";
					gpio = <0xffffffff 0x11 0x0>;
					input;
					dir-changeable;
				};

				P8_35 {
					gpio-name = "P8_35";
					gpio = <0xffffffff 0x8 0x0>;
					input;
					dir-changeable;
				};

				P8_36 {
					gpio-name = "P8_36";
					gpio = <0xffffffff 0x10 0x0>;
					input;
					dir-changeable;
				};

				P8_39 {
					gpio-name = "P8_39";
					gpio = <0xffffffff 0xc 0x0>;
					input;
					dir-changeable;
				};

				P8_40 {
					gpio-name = "P8_40";
					gpio = <0xffffffff 0xd 0x0>;
					input;
					dir-changeable;
				};

				P8_41 {
					gpio-name = "P8_41";
					gpio = <0xffffffff 0xa 0x0>;
					input;
					dir-changeable;
				};

				P8_42 {
					gpio-name = "P8_42";
					gpio = <0xffffffff 0xb 0x0>;
					input;
					dir-changeable;
				};

				P8_43 {
					gpio-name = "P8_43";
					gpio = <0xffffffff 0x8 0x0>;
					input;
					dir-changeable;
				};

				P8_44 {
					gpio-name = "P8_44";
					gpio = <0xffffffff 0x9 0x0>;
					input;
					dir-changeable;
				};

				P8_45 {
					gpio-name = "P8_45";
					gpio = <0xffffffff 0x6 0x0>;
					input;
					dir-changeable;
				};

				P8_46 {
					gpio-name = "P8_46";
					gpio = <0xffffffff 0x7 0x0>;
					input;
					dir-changeable;
				};

				P9_11 {
					gpio-name = "P9_11";
					gpio = <0xffffffff 0x1e 0x0>;
					input;
					dir-changeable;
				};

				P9_13 {
					gpio-name = "P9_13";
					gpio = <0xffffffff 0x1f 0x0>;
					input;
					dir-changeable;
				};

				P9_14 {
					gpio-name = "P9_14";
					gpio = <0xffffffff 0x12 0x0>;
					input;
					dir-changeable;
				};

				P9_15 {
					gpio-name = "P9_15";
					gpio = <0xffffffff 0x10 0x0>;
					input;
					dir-changeable;
				};

				P9_16 {
					gpio-name = "P9_16";
					gpio = <0xffffffff 0x13 0x0>;
					input;
					dir-changeable;
				};

				P9_17 {
					gpio-name = "P9_17";
					gpio = <0xffffffff 0x5 0x0>;
					input;
					dir-changeable;
				};

				P9_18 {
					gpio-name = "P9_18";
					gpio = <0xffffffff 0x4 0x0>;
					input;
					dir-changeable;
				};

				P9_19 {
					gpio-name = "P9_19";
					gpio = <0xffffffff 0xd 0x0>;
					input;
					dir-changeable;
				};

				P9_20 {
					gpio-name = "P9_20";
					gpio = <0xffffffff 0xc 0x0>;
					input;
					dir-changeable;
				};

				P9_21 {
					gpio-name = "P9_21";
					gpio = <0xffffffff 0x3 0x0>;
					input;
					dir-changeable;
				};

				P9_22 {
					gpio-name = "P9_22";
					gpio = <0xffffffff 0x2 0x0>;
					input;
					dir-changeable;
				};

				P9_23 {
					gpio-name = "P9_23";
					gpio = <0xffffffff 0x11 0x0>;
					input;
					dir-changeable;
				};

				P9_24 {
					gpio-name = "P9_24";
					gpio = <0xffffffff 0xf 0x0>;
					input;
					dir-changeable;
				};

				P9_25 {
					gpio-name = "P9_25";
					gpio = <0xffffffff 0x15 0x0>;
					input;
					dir-changeable;
				};

				P9_26 {
					gpio-name = "P9_26";
					gpio = <0xffffffff 0xe 0x0>;
					input;
					dir-changeable;
				};

				P9_27 {
					gpio-name = "P9_27";
					gpio = <0xffffffff 0x13 0x0>;
					input;
					dir-changeable;
				};

				P9_29 {
					gpio-name = "P9_29";
					gpio = <0xffffffff 0xf 0x0>;
					input;
					dir-changeable;
				};

				P9_30 {
					gpio-name = "P9_30";
					gpio = <0xffffffff 0x10 0x0>;
					input;
					dir-changeable;
				};

				P9_31 {
					gpio-name = "P9_31";
					gpio = <0xffffffff 0xe 0x0>;
					input;
					dir-changeable;
				};

				P9_41 {
					gpio-name = "P9_41";
					gpio = <0xffffffff 0x14 0x0>;
					input;
					dir-changeable;
				};

				P9_91 {
					gpio-name = "P9_91";
					gpio = <0xffffffff 0x14 0x0>;
					input;
					dir-changeable;
				};

				P9_42 {
					gpio-name = "P9_42";
					gpio = <0xffffffff 0x7 0x0>;
					input;
					dir-changeable;
				};

				P9_93 {
					gpio-name = "P9_93";
					gpio = <0xffffffff 0x19 0x0>;
					input;
					dir-changeable;
				};

				P9_95 {
					gpio-name = "P9_95";
					gpio = <0xffffffff 0x9 0x0>;
					input;
					dir-changeable;
				};

				P9_96 {
					gpio-name = "P9_96";
					gpio = <0xffffffff 0x8 0x0>;
					input;
					dir-changeable;
				};

				P9_97 {
					gpio-name = "P9_97";
					gpio = <0xffffffff 0x1b 0x0>;
					input;
					dir-changeable;
				};
			};
		};
	};

	fragment@10 {
		target = <0xffffffff>;

		__overlay__ {
			status = "okay";
			pinctrl-names = "default";
			pinctrl-0;
		};
	};

	fragment@11 {
		target = <0xffffffff>;

		__overlay__ {
			status = "okay";
			pinctrl-names = "default";
			pinctrl-0;
		};
	};

	fragment@12 {
		target = <0xffffffff>;

		__overlay__ {
			status = "okay";
			pinctrl-names = "default";
			pinctrl-0;
		};
	};

	fragment@13 {
		target = <0xffffffff>;

		__overlay__ {
			status = "okay";
		};
	};

	fragment@20 {
		target = <0xffffffff>;

		__overlay__ {
			status = "okay";
		};
	};

	fragment@21 {
		target = <0xffffffff>;

		__overlay__ {
			status = "okay";
			pinctrl-names = "default";
			pinctrl-0;
		};
	};

	fragment@22 {
		target = <0xffffffff>;

		__overlay__ {
			status = "okay";
			pinctrl-names = "default";
			pinctrl-0;
		};
	};

	fragment@23 {
		target = <0xffffffff>;

		__overlay__ {
			status = "okay";
		};
	};

	fragment@24 {
		target = <0xffffffff>;

		__overlay__ {
			status = "okay";
			pinctrl-names = "default";
			pinctrl-0;
		};
	};

	fragment@25 {
		target = <0xffffffff>;

		__overlay__ {
			status = "okay";
		};
	};

	fragment@26 {
		target = <0xffffffff>;

		__overlay__ {
			status = "okay";
			pinctrl-names = "default";
			pinctrl-0;
		};
	};

	fragment@27 {
		target = <0xffffffff>;

		__overlay__ {
			status = "okay";
			pinctrl-names = "default";
			pinctrl-0;
		};
	};

	fragment@30 {
		target = <0xffffffff>;

		__overlay__ {
			status = "okay";
			pinctrl-names = "default";
			pinctrl-0;
			clock-frequency = <0x186a0>;
			#address-cells = <0x1>;
			#size-cells = <0x0>;
		};
	};

	fragment@31 {
		target = <0xffffffff>;

		__overlay__ {
			#address-cells = <0x1>;
			#size-cells = <0x0>;
			status = "okay";
			pinctrl-names = "default";
			pinctrl-0;

			spi0channel@0 {
				#address-cells = <0x1>;
				#size-cells = <0x0>;
				compatible = "spidev";
				reg = <0x0>;
				spi-max-frequency = <0xf42400>;
				spi-cpha;
			};

			spi0channel@1 {
				#address-cells = <0x1>;
				#size-cells = <0x0>;
				compatible = "spidev";
				reg = <0x1>;
				spi-max-frequency = <0xf42400>;
			};
		};
	};

	fragment@32 {
		target = <0xffffffff>;

		__overlay__ {
			status = "okay";
			pinctrl-names = "default";
			pinctrl-0;
			#address-cells = <0x1>;
			#size-cells = <0x0>;

			spi1channel@0 {
				#address-cells = <0x1>;
				#size-cells = <0x0>;
				compatible = "spidev";
				reg = <0x0>;
				spi-max-frequency = <0xf42400>;
				spi-cpha;
			};

			spi1channel@1 {
				#address-cells = <0x1>;
				#size-cells = <0x0>;
				compatible = "spidev";
				reg = <0x1>;
				spi-max-frequency = <0xf42400>;
			};
		};
	};

	fragment@33 {
		target = <0xffffffff>;

		__overlay__ {
			status = "okay";
			pinctrl-names = "default";
			pinctrl-0;
		};
	};

	fragment@34 {
		target = <0xffffffff>;

		__overlay__ {
			status = "okay";
			pinctrl-names = "default";
			pinctrl-0;
		};
	};

	fragment@40 {
		target-path = [2f 00];

		__overlay__ {

			ocp {
				#address-cells = <0x1>;
				#size-cells = <0x1>;

				pruss@4a300000 {
					status = "okay";
					linux,phandle = <0x17b>;
					phandle = <0x17b>;
				};
			};
		};
	};

	fragment@50 {
		target = <0xffffffff>;

		__overlay__ {
			pinctrl-names = "default";
			pinctrl-0;
			count_mode = <0x0>;
			swap_inputs = <0x0>;
			invert_qa = <0x1>;
			invert_qb = <0x1>;
			invert_qi = <0x0>;
			invert_qs = <0x0>;
			status = "okay";
		};
	};

	fragment@51 {
		target = <0xffffffff>;

		__overlay__ {
			pinctrl-names = "default";
			pinctrl-0;
			count_mode = <0x0>;
			swap_inputs = <0x0>;
			invert_qa = <0x1>;
			invert_qb = <0x1>;
			invert_qi = <0x0>;
			invert_qs = <0x0>;
			status = "okay";
		};
	};

	fragment@52 {
		target = <0xffffffff>;

		__overlay__ {
			pinctrl-names = "default";
			pinctrl-0;
			count_mode = <0x0>;
			swap_inputs = <0x0>;
			invert_qa = <0x1>;
			invert_qb = <0x1>;
			invert_qi = <0x0>;
			invert_qs = <0x0>;
			status = "okay";
		};
	};

	__symbols__ {
		P8_07_default_pin = "/fragment@0/__overlay__/pinmux_P8_07_default_pin";
		P8_07_gpio_pin = "/fragment@0/__overlay__/pinmux_P8_07_gpio_pin";
		P8_07_gpio_pu_pin = "/fragment@0/__overlay__/pinmux_P8_07_gpio_pu_pin";
		P8_07_gpio_pd_pin = "/fragment@0/__overlay__/pinmux_P8_07_gpio_pd_pin";
		P8_07_gpio_input_pin = "/fragment@0/__overlay__/pinmux_P8_07_gpio_input_pin";
		P8_07_timer_pin = "/fragment@0/__overlay__/pinmux_P8_07_timer_pin";
		P8_08_default_pin = "/fragment@0/__overlay__/pinmux_P8_08_default_pin";
		P8_08_gpio_pin = "/fragment@0/__overlay__/pinmux_P8_08_gpio_pin";
		P8_08_gpio_pu_pin = "/fragment@0/__overlay__/pinmux_P8_08_gpio_pu_pin";
		P8_08_gpio_pd_pin = "/fragment@0/__overlay__/pinmux_P8_08_gpio_pd_pin";
		P8_08_gpio_input_pin = "/fragment@0/__overlay__/pinmux_P8_08_gpio_input_pin";
		P8_08_timer_pin = "/fragment@0/__overlay__/pinmux_P8_08_timer_pin";
		P8_09_default_pin = "/fragment@0/__overlay__/pinmux_P8_09_default_pin";
		P8_09_gpio_pin = "/fragment@0/__overlay__/pinmux_P8_09_gpio_pin";
		P8_09_gpio_pu_pin = "/fragment@0/__overlay__/pinmux_P8_09_gpio_pu_pin";
		P8_09_gpio_pd_pin = "/fragment@0/__overlay__/pinmux_P8_09_gpio_pd_pin";
		P8_09_gpio_input_pin = "/fragment@0/__overlay__/pinmux_P8_09_gpio_input_pin";
		P8_09_timer_pin = "/fragment@0/__overlay__/pinmux_P8_09_timer_pin";
		P8_10_default_pin = "/fragment@0/__overlay__/pinmux_P8_10_default_pin";
		P8_10_gpio_pin = "/fragment@0/__overlay__/pinmux_P8_10_gpio_pin";
		P8_10_gpio_pu_pin = "/fragment@0/__overlay__/pinmux_P8_10_gpio_pu_pin";
		P8_10_gpio_pd_pin = "/fragment@0/__overlay__/pinmux_P8_10_gpio_pd_pin";
		P8_10_gpio_input_pin = "/fragment@0/__overlay__/pinmux_P8_10_gpio_input_pin";
		P8_10_timer_pin = "/fragment@0/__overlay__/pinmux_P8_10_timer_pin";
		P8_13_default_pin = "/fragment@0/__overlay__/pinmux_P8_13_default_pin";
		P8_13_gpio_pin = "/fragment@0/__overlay__/pinmux_P8_13_gpio_pin";
		P8_13_gpio_pu_pin = "/fragment@0/__overlay__/pinmux_P8_13_gpio_pu_pin";
		P8_13_gpio_pd_pin = "/fragment@0/__overlay__/pinmux_P8_13_gpio_pd_pin";
		P8_13_gpio_input_pin = "/fragment@0/__overlay__/pinmux_P8_13_gpio_input_pin";
		P8_13_pwm_pin = "/fragment@0/__overlay__/pinmux_P8_13_pwm_pin";
		P8_19_default_pin = "/fragment@0/__overlay__/pinmux_P8_19_default_pin";
		P8_19_gpio_pin = "/fragment@0/__overlay__/pinmux_P8_19_gpio_pin";
		P8_19_gpio_pu_pin = "/fragment@0/__overlay__/pinmux_P8_19_gpio_pu_pin";
		P8_19_gpio_pd_pin = "/fragment@0/__overlay__/pinmux_P8_19_gpio_pd_pin";
		P8_19_gpio_input_pin = "/fragment@0/__overlay__/pinmux_P8_19_gpio_input_pin";
		P8_19_pwm_pin = "/fragment@0/__overlay__/pinmux_P8_19_pwm_pin";
		P8_27_default_pin = "/fragment@0/__overlay__/pinmux_P8_27_default_pin";
		P8_27_gpio_pin = "/fragment@0/__overlay__/pinmux_P8_27_gpio_pin";
		P8_27_gpio_pu_pin = "/fragment@0/__overlay__/pinmux_P8_27_gpio_pu_pin";
		P8_27_gpio_pd_pin = "/fragment@0/__overlay__/pinmux_P8_27_gpio_pd_pin";
		P8_27_gpio_input_pin = "/fragment@0/__overlay__/pinmux_P8_27_gpio_input_pin";
		P8_27_pruout_pin = "/fragment@0/__overlay__/pinmux_P8_27_pruout_pin";
		P8_27_pruin_pin = "/fragment@0/__overlay__/pinmux_P8_27_pruin_pin";
		P8_28_default_pin = "/fragment@0/__overlay__/pinmux_P8_28_default_pin";
		P8_28_gpio_pin = "/fragment@0/__overlay__/pinmux_P8_28_gpio_pin";
		P8_28_gpio_pu_pin = "/fragment@0/__overlay__/pinmux_P8_28_gpio_pu_pin";
		P8_28_gpio_pd_pin = "/fragment@0/__overlay__/pinmux_P8_28_gpio_pd_pin";
		P8_28_gpio_input_pin = "/fragment@0/__overlay__/pinmux_P8_28_gpio_input_pin";
		P8_28_pruout_pin = "/fragment@0/__overlay__/pinmux_P8_28_pruout_pin";
		P8_28_pruin_pin = "/fragment@0/__overlay__/pinmux_P8_28_pruin_pin";
		P8_29_default_pin = "/fragment@0/__overlay__/pinmux_P8_29_default_pin";
		P8_29_gpio_pin = "/fragment@0/__overlay__/pinmux_P8_29_gpio_pin";
		P8_29_gpio_pu_pin = "/fragment@0/__overlay__/pinmux_P8_29_gpio_pu_pin";
		P8_29_gpio_pd_pin = "/fragment@0/__overlay__/pinmux_P8_29_gpio_pd_pin";
		P8_29_gpio_input_pin = "/fragment@0/__overlay__/pinmux_P8_29_gpio_input_pin";
		P8_29_pruout_pin = "/fragment@0/__overlay__/pinmux_P8_29_pruout_pin";
		P8_29_pruin_pin = "/fragment@0/__overlay__/pinmux_P8_29_pruin_pin";
		P8_30_default_pin = "/fragment@0/__overlay__/pinmux_P8_30_default_pin";
		P8_30_gpio_pin = "/fragment@0/__overlay__/pinmux_P8_30_gpio_pin";
		P8_30_gpio_pu_pin = "/fragment@0/__overlay__/pinmux_P8_30_gpio_pu_pin";
		P8_30_gpio_pd_pin = "/fragment@0/__overlay__/pinmux_P8_30_gpio_pd_pin";
		P8_30_gpio_input_pin = "/fragment@0/__overlay__/pinmux_P8_30_gpio_input_pin";
		P8_30_pruout_pin = "/fragment@0/__overlay__/pinmux_P8_30_pruout_pin";
		P8_30_pruin_pin = "/fragment@0/__overlay__/pinmux_P8_30_pruin_pin";
		P8_31_default_pin = "/fragment@0/__overlay__/pinmux_P8_31_default_pin";
		P8_31_gpio_pin = "/fragment@0/__overlay__/pinmux_P8_31_gpio_pin";
		P8_31_gpio_pu_pin = "/fragment@0/__overlay__/pinmux_P8_31_gpio_pu_pin";
		P8_31_gpio_pd_pin = "/fragment@0/__overlay__/pinmux_P8_31_gpio_pd_pin";
		P8_31_gpio_input_pin = "/fragment@0/__overlay__/pinmux_P8_31_gpio_input_pin";
		P8_31_qep_pin = "/fragment@0/__overlay__/pinmux_P8_31_qep_pin";
		P8_31_uart_pin = "/fragment@0/__overlay__/pinmux_P8_31_uart_pin";
		P8_32_default_pin = "/fragment@0/__overlay__/pinmux_P8_32_default_pin";
		P8_32_gpio_pin = "/fragment@0/__overlay__/pinmux_P8_32_gpio_pin";
		P8_32_gpio_pu_pin = "/fragment@0/__overlay__/pinmux_P8_32_gpio_pu_pin";
		P8_32_gpio_pd_pin = "/fragment@0/__overlay__/pinmux_P8_32_gpio_pd_pin";
		P8_32_gpio_input_pin = "/fragment@0/__overlay__/pinmux_P8_32_gpio_input_pin";
		P8_32_qep_pin = "/fragment@0/__overlay__/pinmux_P8_32_qep_pin";
		P8_33_default_pin = "/fragment@0/__overlay__/pinmux_P8_33_default_pin";
		P8_33_gpio_pin = "/fragment@0/__overlay__/pinmux_P8_33_gpio_pin";
		P8_33_gpio_pu_pin = "/fragment@0/__overlay__/pinmux_P8_33_gpio_pu_pin";
		P8_33_gpio_pd_pin = "/fragment@0/__overlay__/pinmux_P8_33_gpio_pd_pin";
		P8_33_gpio_input_pin = "/fragment@0/__overlay__/pinmux_P8_33_gpio_input_pin";
		P8_33_qep_pin = "/fragment@0/__overlay__/pinmux_P8_33_qep_pin";
		P8_34_default_pin = "/fragment@0/__overlay__/pinmux_P8_34_default_pin";
		P8_34_gpio_pin = "/fragment@0/__overlay__/pinmux_P8_34_gpio_pin";
		P8_34_gpio_pu_pin = "/fragment@0/__overlay__/pinmux_P8_34_gpio_pu_pin";
		P8_34_gpio_pd_pin = "/fragment@0/__overlay__/pinmux_P8_34_gpio_pd_pin";
		P8_34_gpio_input_pin = "/fragment@0/__overlay__/pinmux_P8_34_gpio_input_pin";
		P8_34_pwm_pin = "/fragment@0/__overlay__/pinmux_P8_34_pwm_pin";
		P8_35_default_pin = "/fragment@0/__overlay__/pinmux_P8_35_default_pin";
		P8_35_gpio_pin = "/fragment@0/__overlay__/pinmux_P8_35_gpio_pin";
		P8_35_gpio_pu_pin = "/fragment@0/__overlay__/pinmux_P8_35_gpio_pu_pin";
		P8_35_gpio_pd_pin = "/fragment@0/__overlay__/pinmux_P8_35_gpio_pd_pin";
		P8_35_gpio_input_pin = "/fragment@0/__overlay__/pinmux_P8_35_gpio_input_pin";
		P8_35_qep_pin = "/fragment@0/__overlay__/pinmux_P8_35_qep_pin";
		P8_36_default_pin = "/fragment@0/__overlay__/pinmux_P8_36_default_pin";
		P8_36_gpio_pin = "/fragment@0/__overlay__/pinmux_P8_36_gpio_pin";
		P8_36_gpio_pu_pin = "/fragment@0/__overlay__/pinmux_P8_36_gpio_pu_pin";
		P8_36_gpio_pd_pin = "/fragment@0/__overlay__/pinmux_P8_36_gpio_pd_pin";
		P8_36_gpio_input_pin = "/fragment@0/__overlay__/pinmux_P8_36_gpio_input_pin";
		P8_36_pwm_pin = "/fragment@0/__overlay__/pinmux_P8_36_pwm_pin";
		P8_39_default_pin = "/fragment@0/__overlay__/pinmux_P8_39_default_pin";
		P8_39_gpio_pin = "/fragment@0/__overlay__/pinmux_P8_39_gpio_pin";
		P8_39_gpio_pu_pin = "/fragment@0/__overlay__/pinmux_P8_39_gpio_pu_pin";
		P8_39_gpio_pd_pin = "/fragment@0/__overlay__/pinmux_P8_39_gpio_pd_pin";
		P8_39_gpio_input_pin = "/fragment@0/__overlay__/pinmux_P8_39_gpio_input_pin";
		P8_39_qep_pin = "/fragment@0/__overlay__/pinmux_P8_39_qep_pin";
		P8_39_pruout_pin = "/fragment@0/__overlay__/pinmux_P8_39_pruout_pin";
		P8_39_pruin_pin = "/fragment@0/__overlay__/pinmux_P8_39_pruin_pin";
		P8_40_default_pin = "/fragment@0/__overlay__/pinmux_P8_40_default_pin";
		P8_40_gpio_pin = "/fragment@0/__overlay__/pinmux_P8_40_gpio_pin";
		P8_40_gpio_pu_pin = "/fragment@0/__overlay__/pinmux_P8_40_gpio_pu_pin";
		P8_40_gpio_pd_pin = "/fragment@0/__overlay__/pinmux_P8_40_gpio_pd_pin";
		P8_40_gpio_input_pin = "/fragment@0/__overlay__/pinmux_P8_40_gpio_input_pin";
		P8_40_qep_pin = "/fragment@0/__overlay__/pinmux_P8_40_qep_pin";
		P8_40_pruout_pin = "/fragment@0/__overlay__/pinmux_P8_40_pruout_pin";
		P8_40_pruin_pin = "/fragment@0/__overlay__/pinmux_P8_40_pruin_pin";
		P8_41_default_pin = "/fragment@0/__overlay__/pinmux_P8_41_default_pin";
		P8_41_gpio_pin = "/fragment@0/__overlay__/pinmux_P8_41_gpio_pin";
		P8_41_gpio_pu_pin = "/fragment@0/__overlay__/pinmux_P8_41_gpio_pu_pin";
		P8_41_gpio_pd_pin = "/fragment@0/__overlay__/pinmux_P8_41_gpio_pd_pin";
		P8_41_gpio_input_pin = "/fragment@0/__overlay__/pinmux_P8_41_gpio_input_pin";
		P8_41_qep_pin = "/fragment@0/__overlay__/pinmux_P8_41_qep_pin";
		P8_41_pruout_pin = "/fragment@0/__overlay__/pinmux_P8_41_pruout_pin";
		P8_41_pruin_pin = "/fragment@0/__overlay__/pinmux_P8_41_pruin_pin";
		P8_42_default_pin = "/fragment@0/__overlay__/pinmux_P8_42_default_pin";
		P8_42_gpio_pin = "/fragment@0/__overlay__/pinmux_P8_42_gpio_pin";
		P8_42_gpio_pu_pin = "/fragment@0/__overlay__/pinmux_P8_42_gpio_pu_pin";
		P8_42_gpio_pd_pin = "/fragment@0/__overlay__/pinmux_P8_42_gpio_pd_pin";
		P8_42_gpio_input_pin = "/fragment@0/__overlay__/pinmux_P8_42_gpio_input_pin";
		P8_42_qep_pin = "/fragment@0/__overlay__/pinmux_P8_42_qep_pin";
		P8_42_pruout_pin = "/fragment@0/__overlay__/pinmux_P8_42_pruout_pin";
		P8_42_pruin_pin = "/fragment@0/__overlay__/pinmux_P8_42_pruin_pin";
		P8_43_default_pin = "/fragment@0/__overlay__/pinmux_P8_43_default_pin";
		P8_43_gpio_pin = "/fragment@0/__overlay__/pinmux_P8_43_gpio_pin";
		P8_43_gpio_pu_pin = "/fragment@0/__overlay__/pinmux_P8_43_gpio_pu_pin";
		P8_43_gpio_pd_pin = "/fragment@0/__overlay__/pinmux_P8_43_gpio_pd_pin";
		P8_43_gpio_input_pin = "/fragment@0/__overlay__/pinmux_P8_43_gpio_input_pin";
		P8_43_pwm_pin = "/fragment@0/__overlay__/pinmux_P8_43_pwm_pin";
		P8_43_pruout_pin = "/fragment@0/__overlay__/pinmux_P8_43_pruout_pin";
		P8_43_pruin_pin = "/fragment@0/__overlay__/pinmux_P8_43_pruin_pin";
		P8_44_default_pin = "/fragment@0/__overlay__/pinmux_P8_44_default_pin";
		P8_44_gpio_pin = "/fragment@0/__overlay__/pinmux_P8_44_gpio_pin";
		P8_44_gpio_pu_pin = "/fragment@0/__overlay__/pinmux_P8_44_gpio_pu_pin";
		P8_44_gpio_pd_pin = "/fragment@0/__overlay__/pinmux_P8_44_gpio_pd_pin";
		P8_44_gpio_input_pin = "/fragment@0/__overlay__/pinmux_P8_44_gpio_input_pin";
		P8_44_pwm_pin = "/fragment@0/__overlay__/pinmux_P8_44_pwm_pin";
		P8_44_pruout_pin = "/fragment@0/__overlay__/pinmux_P8_44_pruout_pin";
		P8_44_pruin_pin = "/fragment@0/__overlay__/pinmux_P8_44_pruin_pin";
		P8_45_default_pin = "/fragment@0/__overlay__/pinmux_P8_45_default_pin";
		P8_45_gpio_pin = "/fragment@0/__overlay__/pinmux_P8_45_gpio_pin";
		P8_45_gpio_pu_pin = "/fragment@0/__overlay__/pinmux_P8_45_gpio_pu_pin";
		P8_45_gpio_pd_pin = "/fragment@0/__overlay__/pinmux_P8_45_gpio_pd_pin";
		P8_45_gpio_input_pin = "/fragment@0/__overlay__/pinmux_P8_45_gpio_input_pin";
		P8_45_pwm_pin = "/fragment@0/__overlay__/pinmux_P8_45_pwm_pin";
		P8_45_pruout_pin = "/fragment@0/__overlay__/pinmux_P8_45_pruout_pin";
		P8_45_pruin_pin = "/fragment@0/__overlay__/pinmux_P8_45_pruin_pin";
		P8_46_default_pin = "/fragment@0/__overlay__/pinmux_P8_46_default_pin";
		P8_46_gpio_pin = "/fragment@0/__overlay__/pinmux_P8_46_gpio_pin";
		P8_46_gpio_pu_pin = "/fragment@0/__overlay__/pinmux_P8_46_gpio_pu_pin";
		P8_46_gpio_pd_pin = "/fragment@0/__overlay__/pinmux_P8_46_gpio_pd_pin";
		P8_46_gpio_input_pin = "/fragment@0/__overlay__/pinmux_P8_46_gpio_input_pin";
		P8_46_pwm_pin = "/fragment@0/__overlay__/pinmux_P8_46_pwm_pin";
		P8_46_pruout_pin = "/fragment@0/__overlay__/pinmux_P8_46_pruout_pin";
		P8_46_pruin_pin = "/fragment@0/__overlay__/pinmux_P8_46_pruin_pin";
		P9_11_default_pin = "/fragment@0/__overlay__/pinmux_P9_11_default_pin";
		P9_11_gpio_pin = "/fragment@0/__overlay__/pinmux_P9_11_gpio_pin";
		P9_11_gpio_pu_pin = "/fragment@0/__overlay__/pinmux_P9_11_gpio_pu_pin";
		P9_11_gpio_pd_pin = "/fragment@0/__overlay__/pinmux_P9_11_gpio_pd_pin";
		P9_11_gpio_input_pin = "/fragment@0/__overlay__/pinmux_P9_11_gpio_input_pin";
		P9_11_uart_pin = "/fragment@0/__overlay__/pinmux_P9_11_uart_pin";
		P9_13_default_pin = "/fragment@0/__overlay__/pinmux_P9_13_default_pin";
		P9_13_gpio_pin = "/fragment@0/__overlay__/pinmux_P9_13_gpio_pin";
		P9_13_gpio_pu_pin = "/fragment@0/__overlay__/pinmux_P9_13_gpio_pu_pin";
		P9_13_gpio_pd_pin = "/fragment@0/__overlay__/pinmux_P9_13_gpio_pd_pin";
		P9_13_gpio_input_pin = "/fragment@0/__overlay__/pinmux_P9_13_gpio_input_pin";
		P9_13_uart_pin = "/fragment@0/__overlay__/pinmux_P9_13_uart_pin";
		P9_14_default_pin = "/fragment@0/__overlay__/pinmux_P9_14_default_pin";
		P9_14_gpio_pin = "/fragment@0/__overlay__/pinmux_P9_14_gpio_pin";
		P9_14_gpio_pu_pin = "/fragment@0/__overlay__/pinmux_P9_14_gpio_pu_pin";
		P9_14_gpio_pd_pin = "/fragment@0/__overlay__/pinmux_P9_14_gpio_pd_pin";
		P9_14_gpio_input_pin = "/fragment@0/__overlay__/pinmux_P9_14_gpio_input_pin";
		P9_14_pwm_pin = "/fragment@0/__overlay__/pinmux_P9_14_pwm_pin";
		P9_15_default_pin = "/fragment@0/__overlay__/pinmux_P9_15_default_pin";
		P9_15_gpio_pin = "/fragment@0/__overlay__/pinmux_P9_15_gpio_pin";
		P9_15_gpio_pu_pin = "/fragment@0/__overlay__/pinmux_P9_15_gpio_pu_pin";
		P9_15_gpio_pd_pin = "/fragment@0/__overlay__/pinmux_P9_15_gpio_pd_pin";
		P9_15_gpio_input_pin = "/fragment@0/__overlay__/pinmux_P9_15_gpio_input_pin";
		P9_15_pwm_pin = "/fragment@0/__overlay__/pinmux_P9_15_pwm_pin";
		P9_16_default_pin = "/fragment@0/__overlay__/pinmux_P9_16_default_pin";
		P9_16_gpio_pin = "/fragment@0/__overlay__/pinmux_P9_16_gpio_pin";
		P9_16_gpio_pu_pin = "/fragment@0/__overlay__/pinmux_P9_16_gpio_pu_pin";
		P9_16_gpio_pd_pin = "/fragment@0/__overlay__/pinmux_P9_16_gpio_pd_pin";
		P9_16_gpio_input_pin = "/fragment@0/__overlay__/pinmux_P9_16_gpio_input_pin";
		P9_16_pwm_pin = "/fragment@0/__overlay__/pinmux_P9_16_pwm_pin";
		P9_17_default_pin = "/fragment@0/__overlay__/pinmux_P9_17_default_pin";
		P9_17_gpio_pin = "/fragment@0/__overlay__/pinmux_P9_17_gpio_pin";
		P9_17_gpio_pu_pin = "/fragment@0/__overlay__/pinmux_P9_17_gpio_pu_pin";
		P9_17_gpio_pd_pin = "/fragment@0/__overlay__/pinmux_P9_17_gpio_pd_pin";
		P9_17_gpio_input_pin = "/fragment@0/__overlay__/pinmux_P9_17_gpio_input_pin";
		P9_17_spi_cs_pin = "/fragment@0/__overlay__/pinmux_P9_17_spi_cs_pin";
		P9_17_i2c_pin = "/fragment@0/__overlay__/pinmux_P9_17_i2c_pin";
		P9_17_pwm_pin = "/fragment@0/__overlay__/pinmux_P9_17_pwm_pin";
		P9_17_pru_uart_pin = "/fragment@0/__overlay__/pinmux_P9_17_pru_uart_pin";
		P9_18_default_pin = "/fragment@0/__overlay__/pinmux_P9_18_default_pin";
		P9_18_gpio_pin = "/fragment@0/__overlay__/pinmux_P9_18_gpio_pin";
		P9_18_gpio_pu_pin = "/fragment@0/__overlay__/pinmux_P9_18_gpio_pu_pin";
		P9_18_gpio_pd_pin = "/fragment@0/__overlay__/pinmux_P9_18_gpio_pd_pin";
		P9_18_gpio_input_pin = "/fragment@0/__overlay__/pinmux_P9_18_gpio_input_pin";
		P9_18_spi_pin = "/fragment@0/__overlay__/pinmux_P9_18_spi_pin";
		P9_18_i2c_pin = "/fragment@0/__overlay__/pinmux_P9_18_i2c_pin";
		P9_18_pwm_pin = "/fragment@0/__overlay__/pinmux_P9_18_pwm_pin";
		P9_18_pru_uart_pin = "/fragment@0/__overlay__/pinmux_P9_18_pru_uart_pin";
		P9_19_default_pin = "/fragment@0/__overlay__/pinmux_P9_19_default_pin";
		P9_19_gpio_pin = "/fragment@0/__overlay__/pinmux_P9_19_gpio_pin";
		P9_19_gpio_pu_pin = "/fragment@0/__overlay__/pinmux_P9_19_gpio_pu_pin";
		P9_19_gpio_pd_pin = "/fragment@0/__overlay__/pinmux_P9_19_gpio_pd_pin";
		P9_19_gpio_input_pin = "/fragment@0/__overlay__/pinmux_P9_19_gpio_input_pin";
		P9_19_timer_pin = "/fragment@0/__overlay__/pinmux_P9_19_timer_pin";
		P9_19_can_pin = "/fragment@0/__overlay__/pinmux_P9_19_can_pin";
		P9_19_i2c_pin = "/fragment@0/__overlay__/pinmux_P9_19_i2c_pin";
		P9_19_spi_cs_pin = "/fragment@0/__overlay__/pinmux_P9_19_spi_cs_pin";
		P9_19_pru_uart_pin = "/fragment@0/__overlay__/pinmux_P9_19_pru_uart_pin";
		P9_20_default_pin = "/fragment@0/__overlay__/pinmux_P9_20_default_pin";
		P9_20_gpio_pin = "/fragment@0/__overlay__/pinmux_P9_20_gpio_pin";
		P9_20_gpio_pu_pin = "/fragment@0/__overlay__/pinmux_P9_20_gpio_pu_pin";
		P9_20_gpio_pd_pin = "/fragment@0/__overlay__/pinmux_P9_20_gpio_pd_pin";
		P9_20_gpio_input_pin = "/fragment@0/__overlay__/pinmux_P9_20_gpio_input_pin";
		P9_20_timer_pin = "/fragment@0/__overlay__/pinmux_P9_20_timer_pin";
		P9_20_can_pin = "/fragment@0/__overlay__/pinmux_P9_20_can_pin";
		P9_20_i2c_pin = "/fragment@0/__overlay__/pinmux_P9_20_i2c_pin";
		P9_20_spi_cs_pin = "/fragment@0/__overlay__/pinmux_P9_20_spi_cs_pin";
		P9_20_pru_uart_pin = "/fragment@0/__overlay__/pinmux_P9_20_pru_uart_pin";
		P9_21_default_pin = "/fragment@0/__overlay__/pinmux_P9_21_default_pin";
		P9_21_gpio_pin = "/fragment@0/__overlay__/pinmux_P9_21_gpio_pin";
		P9_21_gpio_pu_pin = "/fragment@0/__overlay__/pinmux_P9_21_gpio_pu_pin";
		P9_21_gpio_pd_pin = "/fragment@0/__overlay__/pinmux_P9_21_gpio_pd_pin";
		P9_21_gpio_input_pin = "/fragment@0/__overlay__/pinmux_P9_21_gpio_input_pin";
		P9_21_spi_pin = "/fragment@0/__overlay__/pinmux_P9_21_spi_pin";
		P9_21_uart_pin = "/fragment@0/__overlay__/pinmux_P9_21_uart_pin";
		P9_21_i2c_pin = "/fragment@0/__overlay__/pinmux_P9_21_i2c_pin";
		P9_21_pwm_pin = "/fragment@0/__overlay__/pinmux_P9_21_pwm_pin";
		P9_21_pru_uart_pin = "/fragment@0/__overlay__/pinmux_P9_21_pru_uart_pin";
		P9_22_default_pin = "/fragment@0/__overlay__/pinmux_P9_22_default_pin";
		P9_22_gpio_pin = "/fragment@0/__overlay__/pinmux_P9_22_gpio_pin";
		P9_22_gpio_pu_pin = "/fragment@0/__overlay__/pinmux_P9_22_gpio_pu_pin";
		P9_22_gpio_pd_pin = "/fragment@0/__overlay__/pinmux_P9_22_gpio_pd_pin";
		P9_22_gpio_input_pin = "/fragment@0/__overlay__/pinmux_P9_22_gpio_input_pin";
		P9_22_spi_sclk_pin = "/fragment@0/__overlay__/pinmux_P9_22_spi_sclk_pin";
		P9_22_uart_pin = "/fragment@0/__overlay__/pinmux_P9_22_uart_pin";
		P9_22_i2c_pin = "/fragment@0/__overlay__/pinmux_P9_22_i2c_pin";
		P9_22_pwm_pin = "/fragment@0/__overlay__/pinmux_P9_22_pwm_pin";
		P9_22_pru_uart_pin = "/fragment@0/__overlay__/pinmux_P9_22_pru_uart_pin";
		P9_23_default_pin = "/fragment@0/__overlay__/pinmux_P9_23_default_pin";
		P9_23_gpio_pin = "/fragment@0/__overlay__/pinmux_P9_23_gpio_pin";
		P9_23_gpio_pu_pin = "/fragment@0/__overlay__/pinmux_P9_23_gpio_pu_pin";
		P9_23_gpio_pd_pin = "/fragment@0/__overlay__/pinmux_P9_23_gpio_pd_pin";
		P9_23_gpio_input_pin = "/fragment@0/__overlay__/pinmux_P9_23_gpio_input_pin";
		P9_23_pwm_pin = "/fragment@0/__overlay__/pinmux_P9_23_pwm_pin";
		P9_24_default_pin = "/fragment@0/__overlay__/pinmux_P9_24_default_pin";
		P9_24_gpio_pin = "/fragment@0/__overlay__/pinmux_P9_24_gpio_pin";
		P9_24_gpio_pu_pin = "/fragment@0/__overlay__/pinmux_P9_24_gpio_pu_pin";
		P9_24_gpio_pd_pin = "/fragment@0/__overlay__/pinmux_P9_24_gpio_pd_pin";
		P9_24_gpio_input_pin = "/fragment@0/__overlay__/pinmux_P9_24_gpio_input_pin";
		P9_24_uart_pin = "/fragment@0/__overlay__/pinmux_P9_24_uart_pin";
		P9_24_can_pin = "/fragment@0/__overlay__/pinmux_P9_24_can_pin";
		P9_24_i2c_pin = "/fragment@0/__overlay__/pinmux_P9_24_i2c_pin";
		P9_24_pru_uart_pin = "/fragment@0/__overlay__/pinmux_P9_24_pru_uart_pin";
		P9_24_pruin_pin = "/fragment@0/__overlay__/pinmux_P9_24_pruin_pin";
		P9_25_default_pin = "/fragment@0/__overlay__/pinmux_P9_25_default_pin";
		P9_25_gpio_pin = "/fragment@0/__overlay__/pinmux_P9_25_gpio_pin";
		P9_25_gpio_pu_pin = "/fragment@0/__overlay__/pinmux_P9_25_gpio_pu_pin";
		P9_25_gpio_pd_pin = "/fragment@0/__overlay__/pinmux_P9_25_gpio_pd_pin";
		P9_25_gpio_input_pin = "/fragment@0/__overlay__/pinmux_P9_25_gpio_input_pin";
		P9_25_qep_pin = "/fragment@0/__overlay__/pinmux_P9_25_qep_pin";
		P9_25_pruout_pin = "/fragment@0/__overlay__/pinmux_P9_25_pruout_pin";
		P9_25_pruin_pin = "/fragment@0/__overlay__/pinmux_P9_25_pruin_pin";
		P9_26_default_pin = "/fragment@0/__overlay__/pinmux_P9_26_default_pin";
		P9_26_gpio_pin = "/fragment@0/__overlay__/pinmux_P9_26_gpio_pin";
		P9_26_gpio_pu_pin = "/fragment@0/__overlay__/pinmux_P9_26_gpio_pu_pin";
		P9_26_gpio_pd_pin = "/fragment@0/__overlay__/pinmux_P9_26_gpio_pd_pin";
		P9_26_gpio_input_pin = "/fragment@0/__overlay__/pinmux_P9_26_gpio_input_pin";
		P9_26_uart_pin = "/fragment@0/__overlay__/pinmux_P9_26_uart_pin";
		P9_26_can_pin = "/fragment@0/__overlay__/pinmux_P9_26_can_pin";
		P9_26_i2c_pin = "/fragment@0/__overlay__/pinmux_P9_26_i2c_pin";
		P9_26_pru_uart_pin = "/fragment@0/__overlay__/pinmux_P9_26_pru_uart_pin";
		P9_26_pruin_pin = "/fragment@0/__overlay__/pinmux_P9_26_pruin_pin";
		P9_27_default_pin = "/fragment@0/__overlay__/pinmux_P9_27_default_pin";
		P9_27_gpio_pin = "/fragment@0/__overlay__/pinmux_P9_27_gpio_pin";
		P9_27_gpio_pu_pin = "/fragment@0/__overlay__/pinmux_P9_27_gpio_pu_pin";
		P9_27_gpio_pd_pin = "/fragment@0/__overlay__/pinmux_P9_27_gpio_pd_pin";
		P9_27_gpio_input_pin = "/fragment@0/__overlay__/pinmux_P9_27_gpio_input_pin";
		P9_27_qep_pin = "/fragment@0/__overlay__/pinmux_P9_27_qep_pin";
		P9_27_pruout_pin = "/fragment@0/__overlay__/pinmux_P9_27_pruout_pin";
		P9_27_pruin_pin = "/fragment@0/__overlay__/pinmux_P9_27_pruin_pin";
		P9_28_default_pin = "/fragment@0/__overlay__/pinmux_P9_28_default_pin";
		P9_28_gpio_pin = "/fragment@0/__overlay__/pinmux_P9_28_gpio_pin";
		P9_28_gpio_pu_pin = "/fragment@0/__overlay__/pinmux_P9_28_gpio_pu_pin";
		P9_28_gpio_pd_pin = "/fragment@0/__overlay__/pinmux_P9_28_gpio_pd_pin";
		P9_28_gpio_input_pin = "/fragment@0/__overlay__/pinmux_P9_28_gpio_input_pin";
		P9_28_pwm_pin = "/fragment@0/__overlay__/pinmux_P9_28_pwm_pin";
		P9_28_pwm2_pin = "/fragment@0/__overlay__/pinmux_P9_28_pwm2_pin";
		P9_28_spi_cs_pin = "/fragment@0/__overlay__/pinmux_P9_28_spi_cs_pin";
		P9_28_pruout_pin = "/fragment@0/__overlay__/pinmux_P9_28_pruout_pin";
		P9_28_pruin_pin = "/fragment@0/__overlay__/pinmux_P9_28_pruin_pin";
		P9_29_default_pin = "/fragment@0/__overlay__/pinmux_P9_29_default_pin";
		P9_29_gpio_pin = "/fragment@0/__overlay__/pinmux_P9_29_gpio_pin";
		P9_29_gpio_pu_pin = "/fragment@0/__overlay__/pinmux_P9_29_gpio_pu_pin";
		P9_29_gpio_pd_pin = "/fragment@0/__overlay__/pinmux_P9_29_gpio_pd_pin";
		P9_29_gpio_input_pin = "/fragment@0/__overlay__/pinmux_P9_29_gpio_input_pin";
		P9_29_pwm_pin = "/fragment@0/__overlay__/pinmux_P9_29_pwm_pin";
		P9_29_spi_pin = "/fragment@0/__overlay__/pinmux_P9_29_spi_pin";
		P9_29_pruout_pin = "/fragment@0/__overlay__/pinmux_P9_29_pruout_pin";
		P9_29_pruin_pin = "/fragment@0/__overlay__/pinmux_P9_29_pruin_pin";
		P9_30_default_pin = "/fragment@0/__overlay__/pinmux_P9_30_default_pin";
		P9_30_gpio_pin = "/fragment@0/__overlay__/pinmux_P9_30_gpio_pin";
		P9_30_gpio_pu_pin = "/fragment@0/__overlay__/pinmux_P9_30_gpio_pu_pin";
		P9_30_gpio_pd_pin = "/fragment@0/__overlay__/pinmux_P9_30_gpio_pd_pin";
		P9_30_gpio_input_pin = "/fragment@0/__overlay__/pinmux_P9_30_gpio_input_pin";
		P9_30_pwm_pin = "/fragment@0/__overlay__/pinmux_P9_30_pwm_pin";
		P9_30_spi_pin = "/fragment@0/__overlay__/pinmux_P9_30_spi_pin";
		P9_30_pruout_pin = "/fragment@0/__overlay__/pinmux_P9_30_pruout_pin";
		P9_30_pruin_pin = "/fragment@0/__overlay__/pinmux_P9_30_pruin_pin";
		P9_31_default_pin = "/fragment@0/__overlay__/pinmux_P9_31_default_pin";
		P9_31_gpio_pin = "/fragment@0/__overlay__/pinmux_P9_31_gpio_pin";
		P9_31_gpio_pu_pin = "/fragment@0/__overlay__/pinmux_P9_31_gpio_pu_pin";
		P9_31_gpio_pd_pin = "/fragment@0/__overlay__/pinmux_P9_31_gpio_pd_pin";
		P9_31_gpio_input_pin = "/fragment@0/__overlay__/pinmux_P9_31_gpio_input_pin";
		P9_31_pwm_pin = "/fragment@0/__overlay__/pinmux_P9_31_pwm_pin";
		P9_31_spi_sclk_pin = "/fragment@0/__overlay__/pinmux_P9_31_spi_sclk_pin";
		P9_31_pruout_pin = "/fragment@0/__overlay__/pinmux_P9_31_pruout_pin";
		P9_31_pruin_pin = "/fragment@0/__overlay__/pinmux_P9_31_pruin_pin";
		P9_41_default_pin = "/fragment@0/__overlay__/pinmux_P9_41_default_pin";
		P9_41_gpio_pin = "/fragment@0/__overlay__/pinmux_P9_41_gpio_pin";
		P9_41_gpio_pu_pin = "/fragment@0/__overlay__/pinmux_P9_41_gpio_pu_pin";
		P9_41_gpio_pd_pin = "/fragment@0/__overlay__/pinmux_P9_41_gpio_pd_pin";
		P9_41_gpio_input_pin = "/fragment@0/__overlay__/pinmux_P9_41_gpio_input_pin";
		P9_41_clkout2_pin = "/fragment@0/__overlay__/pinmux_P9_41_clkout2_pin";
		P9_41_timer_pin = "/fragment@0/__overlay__/pinmux_P9_41_timer_pin";
		P9_41_pruin_pin = "/fragment@0/__overlay__/pinmux_P9_41_pruin_pin";
		P9_91_default_pin = "/fragment@0/__overlay__/pinmux_P9_91_default_pin";
		P9_91_gpio_pin = "/fragment@0/__overlay__/pinmux_P9_91_gpio_pin";
		P9_91_gpio_pu_pin = "/fragment@0/__overlay__/pinmux_P9_91_gpio_pu_pin";
		P9_91_gpio_pd_pin = "/fragment@0/__overlay__/pinmux_P9_91_gpio_pd_pin";
		P9_91_gpio_input_pin = "/fragment@0/__overlay__/pinmux_P9_91_gpio_input_pin";
		P9_91_qep_pin = "/fragment@0/__overlay__/pinmux_P9_91_qep_pin";
		P9_91_pruout_pin = "/fragment@0/__overlay__/pinmux_P9_91_pruout_pin";
		P9_91_pruin_pin = "/fragment@0/__overlay__/pinmux_P9_91_pruin_pin";
		P9_42_default_pin = "/fragment@0/__overlay__/pinmux_P9_42_default_pin";
		P9_42_gpio_pin = "/fragment@0/__overlay__/pinmux_P9_42_gpio_pin";
		P9_42_gpio_pu_pin = "/fragment@0/__overlay__/pinmux_P9_42_gpio_pu_pin";
		P9_42_gpio_pd_pin = "/fragment@0/__overlay__/pinmux_P9_42_gpio_pd_pin";
		P9_42_gpio_input_pin = "/fragment@0/__overlay__/pinmux_P9_42_gpio_input_pin";
		P9_42_pwm_pin = "/fragment@0/__overlay__/pinmux_P9_42_pwm_pin";
		P9_42_uart_pin = "/fragment@0/__overlay__/pinmux_P9_42_uart_pin";
		P9_42_spi_cs_pin = "/fragment@0/__overlay__/pinmux_P9_42_spi_cs_pin";
		P9_42_pru_ecap_pin = "/fragment@0/__overlay__/pinmux_P9_42_pru_ecap_pin";
		P9_42_spi_sclk_pin = "/fragment@0/__overlay__/pinmux_P9_42_spi_sclk_pin";
		P9_93_default_pin = "/fragment@0/__overlay__/pinmux_P9_93_default_pin";
		P9_93_gpio_pin = "/fragment@0/__overlay__/pinmux_P9_93_gpio_pin";
		P9_93_gpio_pu_pin = "/fragment@0/__overlay__/pinmux_P9_93_gpio_pu_pin";
		P9_93_gpio_pd_pin = "/fragment@0/__overlay__/pinmux_P9_93_gpio_pd_pin";
		P9_93_gpio_input_pin = "/fragment@0/__overlay__/pinmux_P9_93_gpio_input_pin";
		P9_95_default_pin = "/fragment@0/__overlay__/pinmux_P9_95_default_pin";
		P9_95_gpio_pin = "/fragment@0/__overlay__/pinmux_P9_95_gpio_pin";
		P9_95_gpio_pu_pin = "/fragment@0/__overlay__/pinmux_P9_95_gpio_pu_pin";
		P9_95_gpio_pd_pin = "/fragment@0/__overlay__/pinmux_P9_95_gpio_pd_pin";
		P9_95_gpio_input_pin = "/fragment@0/__overlay__/pinmux_P9_95_gpio_input_pin";
		P9_96_default_pin = "/fragment@0/__overlay__/pinmux_P9_96_default_pin";
		P9_96_gpio_pin = "/fragment@0/__overlay__/pinmux_P9_96_gpio_pin";
		P9_96_gpio_pu_pin = "/fragment@0/__overlay__/pinmux_P9_96_gpio_pu_pin";
		P9_96_gpio_pd_pin = "/fragment@0/__overlay__/pinmux_P9_96_gpio_pd_pin";
		P9_96_gpio_input_pin = "/fragment@0/__overlay__/pinmux_P9_96_gpio_input_pin";
		P9_97_default_pin = "/fragment@0/__overlay__/pinmux_P9_97_default_pin";
		P9_97_gpio_pin = "/fragment@0/__overlay__/pinmux_P9_97_gpio_pin";
		P9_97_gpio_pu_pin = "/fragment@0/__overlay__/pinmux_P9_97_gpio_pu_pin";
		P9_97_gpio_pd_pin = "/fragment@0/__overlay__/pinmux_P9_97_gpio_pd_pin";
		P9_97_gpio_input_pin = "/fragment@0/__overlay__/pinmux_P9_97_gpio_input_pin";
		pruss = "/fragment@40/__overlay__/ocp/pruss@4a300000";
	};

	__fixups__ {
		am33xx_pinmux = "/fragment@0:target:0";
		ocp = "/fragment@1:target:0", "/fragment@2:target:0";
		gpio2 = "/fragment@2/__overlay__/cape-universal/P8_07:gpio:0", "/fragment@2/__overlay__/cape-universal/P8_08:gpio:0", "/fragment@2/__overlay__/cape-universal/P8_09:gpio:0", "/fragment@2/__overlay__/cape-universal/P8_10:gpio:0", "/fragment@2/__overlay__/cape-universal/P8_27:gpio:0", "/fragment@2/__overlay__/cape-universal/P8_28:gpio:0", "/fragment@2/__overlay__/cape-universal/P8_29:gpio:0", "/fragment@2/__overlay__/cape-universal/P8_30:gpio:0", "/fragment@2/__overlay__/cape-universal/P8_34:gpio:0", "/fragment@2/__overlay__/cape-universal/P8_36:gpio:0", "/fragment@2/__overlay__/cape-universal/P8_39:gpio:0", "/fragment@2/__overlay__/cape-universal/P8_40:gpio:0", "/fragment@2/__overlay__/cape-universal/P8_41:gpio:0", "/fragment@2/__overlay__/cape-universal/P8_42:gpio:0", "/fragment@2/__overlay__/cape-universal/P8_43:gpio:0", "/fragment@2/__overlay__/cape-universal/P8_44:gpio:0", "/fragment@2/__overlay__/cape-universal/P8_45:gpio:0", "/fragment@2/__overlay__/cape-universal/P8_46:gpio:0";
		gpio0 = "/fragment@2/__overlay__/cape-universal/P8_13:gpio:0", "/fragment@2/__overlay__/cape-universal/P8_19:gpio:0", "/fragment@2/__overlay__/cape-universal/P8_31:gpio:0", "/fragment@2/__overlay__/cape-universal/P8_32:gpio:0", "/fragment@2/__overlay__/cape-universal/P8_33:gpio:0", "/fragment@2/__overlay__/cape-universal/P8_35:gpio:0", "/fragment@2/__overlay__/cape-universal/P9_11:gpio:0", "/fragment@2/__overlay__/cape-universal/P9_13:gpio:0", "/fragment@2/__overlay__/cape-universal/P9_17:gpio:0", "/fragment@2/__overlay__/cape-universal/P9_18:gpio:0", "/fragment@2/__overlay__/cape-universal/P9_19:gpio:0", "/fragment@2/__overlay__/cape-universal/P9_20:gpio:0", "/fragment@2/__overlay__/cape-universal/P9_21:gpio:0", "/fragment@2/__overlay__/cape-universal/P9_22:gpio:0", "/fragment@2/__overlay__/cape-universal/P9_24:gpio:0", "/fragment@2/__overlay__/cape-universal/P9_26:gpio:0", "/fragment@2/__overlay__/cape-universal/P9_41:gpio:0", "/fragment@2/__overlay__/cape-universal/P9_42:gpio:0";
		gpio1 = "/fragment@2/__overlay__/cape-universal/P9_14:gpio:0", "/fragment@2/__overlay__/cape-universal/P9_15:gpio:0", "/fragment@2/__overlay__/cape-universal/P9_16:gpio:0", "/fragment@2/__overlay__/cape-universal/P9_23:gpio:0", "/fragment@2/__overlay__/cape-universal/P9_93:gpio:0", "/fragment@2/__overlay__/cape-universal/P9_95:gpio:0", "/fragment@2/__overlay__/cape-universal/P9_96:gpio:0", "/fragment@2/__overlay__/cape-universal/P9_97:gpio:0";
		gpio3 = "/fragment@2/__overlay__/cape-universal/P9_25:gpio:0", "/fragment@2/__overlay__/cape-universal/P9_27:gpio:0", "/fragment@2/__overlay__/cape-universal/P9_29:gpio:0", "/fragment@2/__overlay__/cape-universal/P9_30:gpio:0", "/fragment@2/__overlay__/cape-universal/P9_31:gpio:0", "/fragment@2/__overlay__/cape-universal/P9_91:gpio:0";
		uart1 = "/fragment@10:target:0";
		uart2 = "/fragment@11:target:0";
		uart4 = "/fragment@12:target:0";
		uart5 = "/fragment@13:target:0";
		epwmss0 = "/fragment@20:target:0";
		ehrpwm0 = "/fragment@21:target:0";
		ecap0 = "/fragment@22:target:0";
		epwmss1 = "/fragment@23:target:0";
		ehrpwm1 = "/fragment@24:target:0";
		epwmss2 = "/fragment@25:target:0";
		ehrpwm2 = "/fragment@26:target:0";
		ecap2 = "/fragment@27:target:0";
		i2c1 = "/fragment@30:target:0";
		spi0 = "/fragment@31:target:0";
		spi1 = "/fragment@32:target:0";
		dcan0 = "/fragment@33:target:0";
		dcan1 = "/fragment@34:target:0";
		eqep0 = "/fragment@50:target:0";
		eqep1 = "/fragment@51:target:0";
		eqep2 = "/fragment@52:target:0";
	};

	__local_fixups__ {

		fragment@1 {

			__overlay__ {

				P8_07_pinmux {
					pinctrl-0 = <0x0>;
					pinctrl-1 = <0x0>;
					pinctrl-2 = <0x0>;
					pinctrl-3 = <0x0>;
					pinctrl-4 = <0x0>;
					pinctrl-5 = <0x0>;
				};

				P8_08_pinmux {
					pinctrl-0 = <0x0>;
					pinctrl-1 = <0x0>;
					pinctrl-2 = <0x0>;
					pinctrl-3 = <0x0>;
					pinctrl-4 = <0x0>;
					pinctrl-5 = <0x0>;
				};

				P8_09_pinmux {
					pinctrl-0 = <0x0>;
					pinctrl-1 = <0x0>;
					pinctrl-2 = <0x0>;
					pinctrl-3 = <0x0>;
					pinctrl-4 = <0x0>;
					pinctrl-5 = <0x0>;
				};

				P8_10_pinmux {
					pinctrl-0 = <0x0>;
					pinctrl-1 = <0x0>;
					pinctrl-2 = <0x0>;
					pinctrl-3 = <0x0>;
					pinctrl-4 = <0x0>;
					pinctrl-5 = <0x0>;
				};

				P8_13_pinmux {
					pinctrl-0 = <0x0>;
					pinctrl-1 = <0x0>;
					pinctrl-2 = <0x0>;
					pinctrl-3 = <0x0>;
					pinctrl-4 = <0x0>;
					pinctrl-5 = <0x0>;
				};

				P8_19_pinmux {
					pinctrl-0 = <0x0>;
					pinctrl-1 = <0x0>;
					pinctrl-2 = <0x0>;
					pinctrl-3 = <0x0>;
					pinctrl-4 = <0x0>;
					pinctrl-5 = <0x0>;
				};

				P8_27_pinmux {
					pinctrl-0 = <0x0>;
					pinctrl-1 = <0x0>;
					pinctrl-2 = <0x0>;
					pinctrl-3 = <0x0>;
					pinctrl-4 = <0x0>;
					pinctrl-5 = <0x0>;
					pinctrl-6 = <0x0>;
				};

				P8_28_pinmux {
					pinctrl-0 = <0x0>;
					pinctrl-1 = <0x0>;
					pinctrl-2 = <0x0>;
					pinctrl-3 = <0x0>;
					pinctrl-4 = <0x0>;
					pinctrl-5 = <0x0>;
					pinctrl-6 = <0x0>;
				};

				P8_29_pinmux {
					pinctrl-0 = <0x0>;
					pinctrl-1 = <0x0>;
					pinctrl-2 = <0x0>;
					pinctrl-3 = <0x0>;
					pinctrl-4 = <0x0>;
					pinctrl-5 = <0x0>;
					pinctrl-6 = <0x0>;
				};

				P8_30_pinmux {
					pinctrl-0 = <0x0>;
					pinctrl-1 = <0x0>;
					pinctrl-2 = <0x0>;
					pinctrl-3 = <0x0>;
					pinctrl-4 = <0x0>;
					pinctrl-5 = <0x0>;
					pinctrl-6 = <0x0>;
				};

				P8_31_pinmux {
					pinctrl-0 = <0x0>;
					pinctrl-1 = <0x0>;
					pinctrl-2 = <0x0>;
					pinctrl-3 = <0x0>;
					pinctrl-4 = <0x0>;
					pinctrl-5 = <0x0>;
					pinctrl-6 = <0x0>;
				};

				P8_32_pinmux {
					pinctrl-0 = <0x0>;
					pinctrl-1 = <0x0>;
					pinctrl-2 = <0x0>;
					pinctrl-3 = <0x0>;
					pinctrl-4 = <0x0>;
					pinctrl-5 = <0x0>;
				};

				P8_33_pinmux {
					pinctrl-0 = <0x0>;
					pinctrl-1 = <0x0>;
					pinctrl-2 = <0x0>;
					pinctrl-3 = <0x0>;
					pinctrl-4 = <0x0>;
					pinctrl-5 = <0x0>;
				};

				P8_34_pinmux {
					pinctrl-0 = <0x0>;
					pinctrl-1 = <0x0>;
					pinctrl-2 = <0x0>;
					pinctrl-3 = <0x0>;
					pinctrl-4 = <0x0>;
					pinctrl-5 = <0x0>;
				};

				P8_35_pinmux {
					pinctrl-0 = <0x0>;
					pinctrl-1 = <0x0>;
					pinctrl-2 = <0x0>;
					pinctrl-3 = <0x0>;
					pinctrl-4 = <0x0>;
					pinctrl-5 = <0x0>;
				};

				P8_36_pinmux {
					pinctrl-0 = <0x0>;
					pinctrl-1 = <0x0>;
					pinctrl-2 = <0x0>;
					pinctrl-3 = <0x0>;
					pinctrl-4 = <0x0>;
					pinctrl-5 = <0x0>;
				};

				P8_39_pinmux {
					pinctrl-0 = <0x0>;
					pinctrl-1 = <0x0>;
					pinctrl-2 = <0x0>;
					pinctrl-3 = <0x0>;
					pinctrl-4 = <0x0>;
					pinctrl-5 = <0x0>;
					pinctrl-6 = <0x0>;
					pinctrl-7 = <0x0>;
				};

				P8_40_pinmux {
					pinctrl-0 = <0x0>;
					pinctrl-1 = <0x0>;
					pinctrl-2 = <0x0>;
					pinctrl-3 = <0x0>;
					pinctrl-4 = <0x0>;
					pinctrl-5 = <0x0>;
					pinctrl-6 = <0x0>;
					pinctrl-7 = <0x0>;
				};

				P8_41_pinmux {
					pinctrl-0 = <0x0>;
					pinctrl-1 = <0x0>;
					pinctrl-2 = <0x0>;
					pinctrl-3 = <0x0>;
					pinctrl-4 = <0x0>;
					pinctrl-5 = <0x0>;
					pinctrl-6 = <0x0>;
					pinctrl-7 = <0x0>;
				};

				P8_42_pinmux {
					pinctrl-0 = <0x0>;
					pinctrl-1 = <0x0>;
					pinctrl-2 = <0x0>;
					pinctrl-3 = <0x0>;
					pinctrl-4 = <0x0>;
					pinctrl-5 = <0x0>;
					pinctrl-6 = <0x0>;
					pinctrl-7 = <0x0>;
				};

				P8_43_pinmux {
					pinctrl-0 = <0x0>;
					pinctrl-1 = <0x0>;
					pinctrl-2 = <0x0>;
					pinctrl-3 = <0x0>;
					pinctrl-4 = <0x0>;
					pinctrl-5 = <0x0>;
					pinctrl-6 = <0x0>;
					pinctrl-7 = <0x0>;
				};

				P8_44_pinmux {
					pinctrl-0 = <0x0>;
					pinctrl-1 = <0x0>;
					pinctrl-2 = <0x0>;
					pinctrl-3 = <0x0>;
					pinctrl-4 = <0x0>;
					pinctrl-5 = <0x0>;
					pinctrl-6 = <0x0>;
					pinctrl-7 = <0x0>;
				};

				P8_45_pinmux {
					pinctrl-0 = <0x0>;
					pinctrl-1 = <0x0>;
					pinctrl-2 = <0x0>;
					pinctrl-3 = <0x0>;
					pinctrl-4 = <0x0>;
					pinctrl-5 = <0x0>;
					pinctrl-6 = <0x0>;
					pinctrl-7 = <0x0>;
				};

				P8_46_pinmux {
					pinctrl-0 = <0x0>;
					pinctrl-1 = <0x0>;
					pinctrl-2 = <0x0>;
					pinctrl-3 = <0x0>;
					pinctrl-4 = <0x0>;
					pinctrl-5 = <0x0>;
					pinctrl-6 = <0x0>;
					pinctrl-7 = <0x0>;
				};

				P9_11_pinmux {
					pinctrl-0 = <0x0>;
					pinctrl-1 = <0x0>;
					pinctrl-2 = <0x0>;
					pinctrl-3 = <0x0>;
					pinctrl-4 = <0x0>;
					pinctrl-5 = <0x0>;
				};

				P9_13_pinmux {
					pinctrl-0 = <0x0>;
					pinctrl-1 = <0x0>;
					pinctrl-2 = <0x0>;
					pinctrl-3 = <0x0>;
					pinctrl-4 = <0x0>;
					pinctrl-5 = <0x0>;
				};

				P9_14_pinmux {
					pinctrl-0 = <0x0>;
					pinctrl-1 = <0x0>;
					pinctrl-2 = <0x0>;
					pinctrl-3 = <0x0>;
					pinctrl-4 = <0x0>;
					pinctrl-5 = <0x0>;
				};

				P9_15_pinmux {
					pinctrl-0 = <0x0>;
					pinctrl-1 = <0x0>;
					pinctrl-2 = <0x0>;
					pinctrl-3 = <0x0>;
					pinctrl-4 = <0x0>;
					pinctrl-5 = <0x0>;
				};

				P9_16_pinmux {
					pinctrl-0 = <0x0>;
					pinctrl-1 = <0x0>;
					pinctrl-2 = <0x0>;
					pinctrl-3 = <0x0>;
					pinctrl-4 = <0x0>;
					pinctrl-5 = <0x0>;
				};

				P9_17_pinmux {
					pinctrl-0 = <0x0>;
					pinctrl-1 = <0x0>;
					pinctrl-2 = <0x0>;
					pinctrl-3 = <0x0>;
					pinctrl-4 = <0x0>;
					pinctrl-5 = <0x0>;
					pinctrl-6 = <0x0>;
					pinctrl-7 = <0x0>;
					pinctrl-8 = <0x0>;
				};

				P9_18_pinmux {
					pinctrl-0 = <0x0>;
					pinctrl-1 = <0x0>;
					pinctrl-2 = <0x0>;
					pinctrl-3 = <0x0>;
					pinctrl-4 = <0x0>;
					pinctrl-5 = <0x0>;
					pinctrl-6 = <0x0>;
					pinctrl-7 = <0x0>;
					pinctrl-8 = <0x0>;
				};

				P9_19_pinmux {
					pinctrl-0 = <0x0>;
					pinctrl-1 = <0x0>;
					pinctrl-2 = <0x0>;
					pinctrl-3 = <0x0>;
					pinctrl-4 = <0x0>;
					pinctrl-5 = <0x0>;
					pinctrl-6 = <0x0>;
					pinctrl-7 = <0x0>;
					pinctrl-8 = <0x0>;
					pinctrl-9 = <0x0>;
				};

				P9_20_pinmux {
					pinctrl-0 = <0x0>;
					pinctrl-1 = <0x0>;
					pinctrl-2 = <0x0>;
					pinctrl-3 = <0x0>;
					pinctrl-4 = <0x0>;
					pinctrl-5 = <0x0>;
					pinctrl-6 = <0x0>;
					pinctrl-7 = <0x0>;
					pinctrl-8 = <0x0>;
					pinctrl-9 = <0x0>;
				};

				P9_21_pinmux {
					pinctrl-0 = <0x0>;
					pinctrl-1 = <0x0>;
					pinctrl-2 = <0x0>;
					pinctrl-3 = <0x0>;
					pinctrl-4 = <0x0>;
					pinctrl-5 = <0x0>;
					pinctrl-6 = <0x0>;
					pinctrl-7 = <0x0>;
					pinctrl-8 = <0x0>;
					pinctrl-9 = <0x0>;
				};

				P9_22_pinmux {
					pinctrl-0 = <0x0>;
					pinctrl-1 = <0x0>;
					pinctrl-2 = <0x0>;
					pinctrl-3 = <0x0>;
					pinctrl-4 = <0x0>;
					pinctrl-5 = <0x0>;
					pinctrl-6 = <0x0>;
					pinctrl-7 = <0x0>;
					pinctrl-8 = <0x0>;
					pinctrl-9 = <0x0>;
				};

				P9_23_pinmux {
					pinctrl-0 = <0x0>;
					pinctrl-1 = <0x0>;
					pinctrl-2 = <0x0>;
					pinctrl-3 = <0x0>;
					pinctrl-4 = <0x0>;
					pinctrl-5 = <0x0>;
				};

				P9_24_pinmux {
					pinctrl-0 = <0x0>;
					pinctrl-1 = <0x0>;
					pinctrl-2 = <0x0>;
					pinctrl-3 = <0x0>;
					pinctrl-4 = <0x0>;
					pinctrl-5 = <0x0>;
					pinctrl-6 = <0x0>;
					pinctrl-7 = <0x0>;
					pinctrl-8 = <0x0>;
					pinctrl-9 = <0x0>;
				};

				P9_25_pinmux {
					pinctrl-0 = <0x0>;
					pinctrl-1 = <0x0>;
					pinctrl-2 = <0x0>;
					pinctrl-3 = <0x0>;
					pinctrl-4 = <0x0>;
					pinctrl-5 = <0x0>;
					pinctrl-6 = <0x0>;
					pinctrl-7 = <0x0>;
				};

				P9_26_pinmux {
					pinctrl-0 = <0x0>;
					pinctrl-1 = <0x0>;
					pinctrl-2 = <0x0>;
					pinctrl-3 = <0x0>;
					pinctrl-4 = <0x0>;
					pinctrl-5 = <0x0>;
					pinctrl-6 = <0x0>;
					pinctrl-7 = <0x0>;
					pinctrl-8 = <0x0>;
					pinctrl-9 = <0x0>;
				};

				P9_27_pinmux {
					pinctrl-0 = <0x0>;
					pinctrl-1 = <0x0>;
					pinctrl-2 = <0x0>;
					pinctrl-3 = <0x0>;
					pinctrl-4 = <0x0>;
					pinctrl-5 = <0x0>;
					pinctrl-6 = <0x0>;
					pinctrl-7 = <0x0>;
				};

				P9_29_pinmux {
					pinctrl-0 = <0x0>;
					pinctrl-1 = <0x0>;
					pinctrl-2 = <0x0>;
					pinctrl-3 = <0x0>;
					pinctrl-4 = <0x0>;
					pinctrl-5 = <0x0>;
					pinctrl-6 = <0x0>;
					pinctrl-7 = <0x0>;
					pinctrl-8 = <0x0>;
				};

				P9_30_pinmux {
					pinctrl-0 = <0x0>;
					pinctrl-1 = <0x0>;
					pinctrl-2 = <0x0>;
					pinctrl-3 = <0x0>;
					pinctrl-4 = <0x0>;
					pinctrl-5 = <0x0>;
					pinctrl-6 = <0x0>;
					pinctrl-7 = <0x0>;
					pinctrl-8 = <0x0>;
				};

				P9_31_pinmux {
					pinctrl-0 = <0x0>;
					pinctrl-1 = <0x0>;
					pinctrl-2 = <0x0>;
					pinctrl-3 = <0x0>;
					pinctrl-4 = <0x0>;
					pinctrl-5 = <0x0>;
					pinctrl-6 = <0x0>;
					pinctrl-7 = <0x0>;
					pinctrl-8 = <0x0>;
				};

				P9_41_pinmux {
					pinctrl-0 = <0x0>;
					pinctrl-1 = <0x0>;
					pinctrl-2 = <0x0>;
					pinctrl-3 = <0x0>;
					pinctrl-4 = <0x0>;
					pinctrl-5 = <0x0>;
					pinctrl-6 = <0x0>;
					pinctrl-7 = <0x0>;
				};

				P9_91_pinmux {
					pinctrl-0 = <0x0>;
					pinctrl-1 = <0x0>;
					pinctrl-2 = <0x0>;
					pinctrl-3 = <0x0>;
					pinctrl-4 = <0x0>;
					pinctrl-5 = <0x0>;
					pinctrl-6 = <0x0>;
					pinctrl-7 = <0x0>;
				};

				P9_42_pinmux {
					pinctrl-0 = <0x0>;
					pinctrl-1 = <0x0>;
					pinctrl-2 = <0x0>;
					pinctrl-3 = <0x0>;
					pinctrl-4 = <0x0>;
					pinctrl-5 = <0x0>;
					pinctrl-6 = <0x0>;
					pinctrl-7 = <0x0>;
					pinctrl-8 = <0x0>;
					pinctrl-9 = <0x0>;
				};

				P9_93_pinmux {
					pinctrl-0 = <0x0>;
					pinctrl-1 = <0x0>;
					pinctrl-2 = <0x0>;
					pinctrl-3 = <0x0>;
					pinctrl-4 = <0x0>;
				};

				P9_95_pinmux {
					pinctrl-0 = <0x0>;
					pinctrl-1 = <0x0>;
					pinctrl-2 = <0x0>;
					pinctrl-3 = <0x0>;
					pinctrl-4 = <0x0>;
				};

				P9_96_pinmux {
					pinctrl-0 = <0x0>;
					pinctrl-1 = <0x0>;
					pinctrl-2 = <0x0>;
					pinctrl-3 = <0x0>;
					pinctrl-4 = <0x0>;
				};

				P9_97_pinmux {
					pinctrl-0 = <0x0>;
					pinctrl-1 = <0x0>;
					pinctrl-2 = <0x0>;
					pinctrl-3 = <0x0>;
					pinctrl-4 = <0x0>;
				};
			};
		};
	};
};
